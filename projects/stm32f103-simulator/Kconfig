## projects/stm32f103-simulator/Kconfig
```kconfig
mainmenu "OneOS Configuration"

#Define the relative path to root directory of os code
OS_ROOT=../..
SRC_HAL=st

config BOARD_STM32F103RCT6
    bool
	select SOC_STM32F1XX
	select OS_USING_COMPONENTS_INIT
    select OS_USING_USER_MAIN
    default y
	
source "$OS_ROOT/Kconfig"
```

## projects/stm32l051-st-32/Kconfig
```kconfig
mainmenu "One-Os Configuration"

#Define the relative path to root directory of os code
OS_ROOT=../..
SRC_HAL=st

config BOARD_SMOKE_ALARM
    bool
	select SOC_STM32L051XX
	select OS_USING_COMPONENTS_INIT
    select OS_USING_USER_MAIN
    default y
	
source "$OS_ROOT/Kconfig"
```

## projects/stm32l452-st-nucleo/Kconfig
```kconfig
mainmenu "OneOS Configuration"

#Define the relative path to root directory of os code
OS_ROOT=../..
SRC_HAL=st

config BOARD_STM32L452_NUCLEO
    bool
    select SOC_STM32L452xx
    default y
    
source "$OS_ROOT/Kconfig"
```

## projects/stm32l475-cmcc-oneos/cmiot_pkgs/Kconfig
```kconfig
menu "CMIOT components"

menu "bus test"
config PKG_USING_BUSTEST
    bool "Enable bus test"
    default n
    help 
    the function depend on USE_DRIVER_TEST

config USE_DRIVER_TEST
    bool "Enable bus test driver"
    default n
    
endmenu

menu "mass storage"
config PKG_USING_MASSSOTRAGE
    bool "Enable mass storage"
    select PKG_USING_USB_CTL_DRV
    select PKG_USING_USB_CLASS
    select PKG_USING_USB_CORE
    default n

config PKG_USING_USB_CTL_DRV
    bool "Enable usb control driver"
    default n

config PKG_USING_USB_CLASS
    bool "Enable usb device class"
    default n

config PKG_USING_USB_CORE
    bool "Enable usb device core"
    default n


    
endmenu

menu "Hard SE"
	config	PKG_USING_SE
		bool "Enable hard se"
		default n
endmenu

endmenu
```

## thirdparty/Kconfig
```kconfig
menu "Thirdparty"
    source "$OS_ROOT/thirdparty/cJSON-v1.7.12/Kconfig"
    source "$OS_ROOT/thirdparty/easyflash-v4.1/Kconfig"
    source "$OS_ROOT/thirdparty/netutils-v1.0.0/ntp/Kconfig"
    source "$OS_ROOT/thirdparty/webclient-v2.0.0/Kconfig"    
    source "$OS_ROOT/thirdparty/Aliiotkit-v3.1.0/Kconfig"
    source "$OS_ROOT/thirdparty/MicroPython/Kconfig"
endmenu
```

## thirdparty/MicroPython/Kconfig
```kconfig
menu "MicroPython"
config PKG_USING_MICROPYTHON
    bool "Enable MicroPython"
    default n
	
	if PKG_USING_MICROPYTHON
		config MICROPY_PY_ONENET
			bool "Enable micropython onenet module"
			default n
		config PKG_MICROPYTHON_DEVICE
			bool "Enable micropython device module"
			default n
		
		config MICROPY_USING_AMS
			bool "Enable micropython application management system"
			default n
	endif
	
	
endmenu
```

## thirdparty/easyflash-v4.1/Kconfig
```kconfig
menu "Easyflash"

    config PKG_USING_EASYFLASH
        bool "EasyFlash: Lightweight embedded flash memory library."
        default n

    if PKG_USING_EASYFLASH

        config PKG_EASYFLASH_ENV_SETTING_SIZE
            int
            prompt "ENV setting size. MUST be word alignment"
            default 2048

        config PKG_EASYFLASH_ERASE_GRAN
            int
            prompt "Erase minimum granularity"
            default 4096

        config PKG_EASYFLASH_START_ADDR
            int
            prompt "Start addr on flash or partition"
            default 0

        config PKG_EASYFLASH_IAP
            bool
            prompt "IAP: In Application Programming"
            default n

        config PKG_EASYFLASH_DEBUG
            bool "Enable debug log output"
            default n

        config PKG_EASYFLASH_ENV_AUTO_UPDATE
            bool
            prompt "Auto update ENV to latest default when current ENV version number is changed."
            default n

        if PKG_EASYFLASH_ENV_AUTO_UPDATE
            config PKG_EASYFLASH_ENV_VER_NUM
                int
                prompt "Setting current ENV version number"
                default 0
        endif

        config PKG_EASYFLASH_LOG
            bool
            prompt "LOG: Save logs on flash"
            default n

        if PKG_EASYFLASH_LOG
            config PKG_EASYFLASH_LOG_AREA_SIZE
                int
                prompt "Saved log area size. MUST be aligned by erase minimum granularity"
                default 0
        endif
        
   
    endif

endmenu
   

   

    

 
```

## thirdparty/netutils-v1.0.0/ntp/Kconfig
```kconfig
menu "NTP"

config PKG_USING_NTP
    bool "Enable NTP(Network Time Protocol) client"
    select NET_USING_BSD
    default n

if PKG_USING_NTP
    config NETUTILS_NTP_TIMEZONE
        int "Timezone for calculate local time"
        range -12 12
        default 8

    config NETUTILS_NTP_HOSTNAME
        string "NTP server name1"
        default "cn.ntp.org.cn"

    config NETUTILS_NTP_HOSTNAME2
        string "NTP server name2"
        default "ntp.ntsc.ac.cn"

    config NETUTILS_NTP_HOSTNAME3
        string "NTP server name3"
        default "edu.ntp.org.cn"

endif

endmenu
```

## thirdparty/webclient-v2.0.0/Kconfig
```kconfig
menu "WebClient"

config PKG_USING_WEBCLIENT
    bool "WebClient: A HTTP/HTTPS Client for OneOS"
    default n
    select NET_USING_BSD

if PKG_USING_WEBCLIENT


    if !PKG_USING_WEBCLIENT_V100
                
        config WEBCLIENT_USING_SAMPLES
            bool "Enable webclient GET/POST samples"
            default n
            
    endif
                
    if PKG_USING_WEBCLIENT_V201 || PKG_USING_WEBCLIENT_V200|| PKG_USING_WEBCLIENT_V100
    
        config WEBCLIENT_USING_TLS
            bool "Enable support tls protocol"
            default n
            select SECURITY_USING_MBEDTLS
    
    endif 

    choice

        prompt "Version"
        help
            Select the webclient version
        default PKG_USING_WEBCLIENT_V200
            
        config PKG_USING_WEBCLIENT_V200
            bool "v2.0.0"

    endchoice

    config PKG_WEBCLIENT_VER
        string
        default "v2.0.0"    if PKG_USING_WEBCLIENT_V200

endif

endmenu
```
