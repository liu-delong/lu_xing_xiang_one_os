## drivers/usb/Kconfig
```kconfig
menu "USB"
    config OS_USING_USB_DEVICE
        bool "Using USB device"
        default n
        if OS_USING_USB_DEVICE || OS_USING_USB_HOST
            config OS_USBD_TASK_STACK_SZ
                int "usb task stack size"
                default 4096
        endif
        if OS_USING_USB_DEVICE
            config USB_VENDOR_ID
                hex "USB Vendor ID"
                default 0x0FFE
            config USB_PRODUCT_ID
                hex "USB Product ID"
                default 0x0001

            config OS_USB_DEVICE_COMPOSITE
                bool "Enable composite device"
                default n
                choice
                    prompt "Device type"
                    default _OS_USB_DEVICE_NONE
                    depends on !OS_USB_DEVICE_COMPOSITE
                        config _OS_USB_DEVICE_NONE
                            bool "Using custom class by register interface"
                            select OS_USB_DEVICE_NONE
                        config _OS_USB_DEVICE_CDC
                            bool "Enable to use device as CDC device"
                            select OS_USB_DEVICE_CDC
                        config _OS_USB_DEVICE_MSTORAGE
                            bool "Enable to use device as Mass Storage device"
                            select OS_USB_DEVICE_MSTORAGE
                        config _OS_USB_DEVICE_HID
                            bool "Enable to use device as HID device"
                            select OS_USB_DEVICE_HID
                        config _OS_USB_DEVICE_RNDIS
                            bool "Enable to use device as rndis device"
                            select OS_USB_DEVICE_RNDIS
                            depends on NET_USING_LWIP
                        config _OS_USB_DEVICE_ECM
                            bool "Enable to use device as ecm device"
                            select OS_USB_DEVICE_ECM
                            depends on NET_USING_LWIP
                        config _OS_USB_DEVICE_WINUSB
                            bool "Enable to use device as winusb device"
                            select OS_USB_DEVICE_WINUSB
                        config _OS_USB_DEVICE_AUDIO
                            bool "Enable to use device as audio device"
                            select OS_USB_DEVICE_AUDIO
                endchoice

                    config OS_USB_DEVICE_CDC
                        bool "Enable to use device as CDC device"
                        default n
                    config OS_USB_DEVICE_NONE
                        bool
                        default y
                    config OS_USB_DEVICE_MSTORAGE
                        bool "Enable to use device as Mass Storage device"
                        default n
                    config OS_USB_DEVICE_HID
                        bool "Enable to use device as HID device"
                        default n
                    config OS_USB_DEVICE_RNDIS
                        bool "Enable to use device as rndis device"
                        default n
                        depends on NET_USING_LWIP
                    config OS_USB_DEVICE_ECM
                        bool "Enable to use device as ecm device"
                        default n
                        depends on NET_USING_LWIP
                    config OS_USB_DEVICE_WINUSB
                        bool "Enable to use device as winusb device"
                        default n
                    config OS_USB_DEVICE_AUDIO
                        bool "Enable to use device as audio device"
                        default n

                if OS_USB_DEVICE_CDC
                    config OS_VCOM_TASK_STK_SIZE
                        int "virtual com task stack size"
                        default 512
                    config OS_VCOM_TX_USE_DMA
                        bool "Enable to use dma for vcom tx"
                        default n
                    config OS_VCOM_SERNO
                        string "serial number of virtual com"
                        default "32021919830108"
                    config OS_VCOM_SER_LEN
                        int "serial number length of virtual com"
                        default 14
                    config OS_VCOM_TX_TIMEOUT
                        int "tx timeout(ticks) of virtual com"
                        default 1000
                endif
                if OS_USB_DEVICE_WINUSB
                    config OS_WINUSB_GUID
                    string "Guid for winusb"
                    default "{6860DC3C-C05F-4807-8807-1CA861CC1D66}"
                endif
                if OS_USB_DEVICE_MSTORAGE
                    config OS_USB_MSTORAGE_DISK_NAME
                    string "msc class disk name"
                    default "flash0"
                endif

                if OS_USB_DEVICE_RNDIS
                    config RNDIS_DELAY_LINK_UP
                        bool "Delay linkup media connection"
                        select OS_USING_TIMER_SOFT
                        default n
                endif

                if OS_USB_DEVICE_HID
                    config OS_USB_DEVICE_HID_KEYBOARD
                        bool "Use to HID device as Keyboard"
                        default n
                    if OS_USB_DEVICE_HID_KEYBOARD
                        config OS_USB_DEVICE_HID_KEYBOARD_NUMBER
                        int "Number of Keyboard(max 3)"
                        default 1
                        range 1 3
                    endif
                    config OS_USB_DEVICE_HID_MOUSE
                        bool "Use to HID device as Mouse"
                        default n
                    config OS_USB_DEVICE_HID_GENERAL
                        bool "Use to HID device as General HID device"
                        default y
                        if OS_USB_DEVICE_HID_GENERAL
                            config OS_USB_DEVICE_HID_GENERAL_OUT_REPORT_LENGTH
                                int "General HID device out report length"
                                default 63
                                range 0 63

                            config OS_USB_DEVICE_HID_GENERAL_IN_REPORT_LENGTH
                                int "General HID device in report length"
                                default 63
                                range 0 63
                        endif
                    config OS_USB_DEVICE_HID_MEDIA
                        bool "Use to HID device as media keyboard"
                        default y
                endif
                if OS_USB_DEVICE_AUDIO
                    config OS_USB_DEVICE_AUDIO_MIC
                        bool "Use usb mic device as audio device"
                        default n
                        if OS_USB_DEVICE_AUDIO_MIC
                            config OS_USBD_MIC_DEVICE_NAME
                            string "audio mic device name"
                            default "mic0"
                        endif
                    config OS_USB_DEVICE_AUDIO_SPEAKER
                        bool "Use usb speaker device as audio device"
                        default n
                        if OS_USB_DEVICE_AUDIO_SPEAKER
                            config OS_USBD_SPEAKER_DEVICE_NAME
                            string "audio speaker device name"
                            default "sound0"
                        endif
                endif
        endif
endmenu
```

## drivers/wlan/Kconfig
```kconfig
menu "WLAN"
menuconfig OS_USING_WIFI
    bool "Using Wi-Fi framework"
    default n

    if OS_USING_WIFI
        config OS_WLAN_DEVICE_STA_NAME
            string "The device name for station"
            default "wlan0"

        config OS_WLAN_DEVICE_AP_NAME
            string "The device name for ap"
            default "wlan1"

        config OS_WLAN_SSID_MAX_LENGTH
            int "SSID maximum length"
            default 32

        config OS_WLAN_PASSWORD_MAX_LENGTH
            int "Password maximum length"
            default 32

        config OS_WLAN_DEV_EVENT_NUM
            int "Driver events maxcount"
            default 2

        config OS_WLAN_MANAGE_ENABLE
            bool "Connection management Enable"
            default y

        if OS_WLAN_MANAGE_ENABLE
            config OS_WLAN_SCAN_WAIT_MS
                int "Set scan timeout time(ms)"
                default 10000

            config OS_WLAN_CONNECT_WAIT_MS
                int "Set connect timeout time(ms)"
                default 10000

            config OS_WLAN_SCAN_SORT
                bool "Automatic sorting of scan results"
                default y

            config OS_WLAN_MSH_CMD_ENABLE
                bool "MSH command Enable"
                default y

            config OS_WLAN_AUTO_CONNECT_ENABLE
                bool "Auto connect Enable"
                select OS_WLAN_CFG_ENABLE
                select OS_WLAN_WORK_TASK_ENABLE
                default y

            if OS_WLAN_AUTO_CONNECT_ENABLE
                config AUTO_CONNECTION_PERIOD_MS
                    int "Auto connect period(ms)"
                    default 2000
            endif
        endif

        config OS_WLAN_CFG_ENABLE
            bool "WiFi information automatically saved Enable"
            default y

        if OS_WLAN_CFG_ENABLE
            config OS_WLAN_CFG_INFO_MAX
                int "Maximum number of WiFi information automatically saved"
                default 3
        endif

        config OS_WLAN_PROT_ENABLE
            bool "Transport protocol manage Enable"
            default y

        if OS_WLAN_PROT_ENABLE
            config OS_WLAN_PROT_NAME_LEN
                int "Transport protocol name length"
                default 8

            config OS_WLAN_PROT_MAX
                int "Transport protocol maxcount"
                default 2

            config OS_WLAN_DEFAULT_PROT
                string "Default transport protocol"
                default "lwip"

            config OS_WLAN_PROT_LWIP_ENABLE
                bool "LWIP transport protocol Enable"
                select NET_USING_LWIP
                default y

            if OS_WLAN_PROT_LWIP_ENABLE
                config OS_WLAN_PROT_LWIP_NAME
                    string "LWIP transport protocol name"
                    default "lwip"

                config OS_WLAN_PROT_LWIP_PBUF_FORCE
                    bool "Forced use of PBUF transmission"
                    default n
            endif
        endif

        config OS_WLAN_WORK_TASK_ENABLE
            bool "WLAN work queue task Enable"
            default y

        if OS_WLAN_WORK_TASK_ENABLE
            config OS_WLAN_WORKQUEUE_TASK_NAME
                string "WLAN work queue task name"
                default "wlan"

            config OS_WLAN_WORKQUEUE_TASK_SIZE
                int "WLAN work queue task size"
                default 2048

            config OS_WLAN_WORKQUEUE_TASK_PRIO
                int "WLAN work queue task priority"
                default 15
        endif

        menuconfig OS_WLAN_DEBUG
            bool "Enable WLAN Debugging Options"
            default n

        if OS_WLAN_DEBUG
            config OS_WLAN_CMD_DEBUG
                bool "Enable Debugging of wlan_cmd.c"
                default n

            config OS_WLAN_MGNT_DEBUG
                bool "Enable Debugging of wlan_mgnt.c"
                default n

            config OS_WLAN_DEV_DEBUG
                bool "Enable Debugging of wlan_dev.c"
                default n

            config OS_WLAN_PROT_DEBUG
                bool "Enable Debugging of wlan_prot.c"
                default n

            config OS_WLAN_CFG_DEBUG
                bool "Enable Debugging of wlan_cfg.c"
                default n

            config OS_WLAN_LWIP_DEBUG
                bool "Enable Debugging of wlan_lwip.c"
                default n
        endif        
    endif
    
    source "$OS_ROOT/drivers/wlan/ap6181/Kconfig"
endmenu
```

## drivers/wlan/ap6181/Kconfig
```kconfig
config BSP_USING_WIFI_AP6181
    bool "Enable Wi-Fi AP6181"
    select OS_USING_SDIO
    select OS_USING_WIFI
    select OS_WLAN_PROT_LWIP_PBUF_FORCE
    select OS_USING_LWIP
    select OS_USING_LIBC
    select OS_USING_POSIX
    select OS_USING_VFS
    select OS_USING_SAL
    select OS_USING_RTTHREAD_ADAPTER
    default n

    if BSP_USING_WIFI_AP6181
        config BSP_AP6181_REG_ON_PIN
            int "AP6181 wifi reg on pin"
            default 49
        config BSP_AP6181_IRQ_PIN
            int "AP6181 interrupt pin"
            default 37
        config BSP_AP6181_THREAD_INIT
            bool "Using Thread Initialize WiFi"
            default n
        config BSP_AP6181_AUTO_INIT
            bool "Using WiFi Automatically Initialization"
            default y
    endif
    
```

## libc/Kconfig
```kconfig
menu "C standard library"

config OS_USING_LIBC
    bool "Enable libc APIs from toolchain"
    default y
	
endmenu
```

## osal/cmsis/Kconfig
```kconfig
menu "CMSIS compatibility layer"

config OS_USING_CMSIS_API
    bool "Enable CMSIS compatibility layer"
	select OS_USING_EVENT
    default n
	
endmenu
```

## osal/freertos/Kconfig
```kconfig
menu "FreeRTOS compatibility layer"

config OS_USING_FREERTOS_API_V8_2_0
    bool "Enable FreeRTOS compatibility layer V8.2.0"
    default n
	
endmenu
```

## osal/posix/Kconfig
```kconfig
menu "POSIX compatibility layer"

config OS_USING_PTHREADS
    bool "Enable pthreads"
    select OS_USING_LIBC
    default n

if OS_USING_PTHREADS
    config PTHREAD_NUM_MAX
    int "Maximum number of pthreads"
    default 8
endif

if OS_USING_LIBC && OS_USING_VFS
    config OS_USING_POSIX
        bool "Enable POSIX layer for poll/select, stdin etc"
        select OS_USING_VFS_DEVFS
        select OS_USING_WAITQUEUE
        default y

    if OS_USING_POSIX
    config OS_USING_POSIX_MMAP
        bool "Enable mmap"
        default n

    config OS_USING_POSIX_TERMIOS
        bool "Enable termios feature"
        default n

    config OS_USING_POSIX_AIO
        bool "Enable aio"
        default n
    endif
endif

endmenu
```

## osal/rtthread/Kconfig
```kconfig
menu "RT-Thread compatibility layer"

config OS_USING_RTTHREAD_ADAPTER
    bool "Enable RT-Thread compatibility layer"
    default n	
endmenu
```

## projects/apollo2-dev-board/Kconfig
```kconfig
mainmenu "OneOS Configuration"

#Define the relative path to root directory of os code
OS_ROOT=../..
SRC_HAL=apollo

config BOARD_ATK_APOLLO2
    bool
    select SOC_APOLLO2_XXX
    default y
    
source "$OS_ROOT/Kconfig"
```

## projects/apollo_th/Kconfig
```kconfig
mainmenu "OneOS Configuration"

#Define the relative path to root directory of os code
OS_ROOT=../..
SRC_HAL=apollo

config BOARD_ATK_PANDORA
    bool
    select SOC_APOLLO_XXX
    default y
    
source "$OS_ROOT/Kconfig"
```

## projects/esp32/Kconfig
```kconfig
mainmenu "OneOS Configuration"

#Define the relative path to root directory of os code
OS_ROOT = ../..
SRC_HAL = ESP32

config BOARD_ESP32
    bool
    select SOC_FAMILY_ESP32
    select ARCH_XTENSA_LX6
    default y
    
source "$OS_ROOT/Kconfig"
```

## projects/fm33a0xx-oneos/Kconfig
```kconfig
mainmenu "OneOs Configuration"

#Define the relative path to root directory of os code
OS_ROOT=../..
SRC_HAL=fm

config BOARD_FM_L
    bool
    select SOC_FM33A0XX
    default y
    
source "$OS_ROOT/Kconfig"
```

## projects/gd32f450z-eval/Kconfig
```kconfig
mainmenu "OneOS Configuration"

#Define the relative path to root directory of os code
OS_ROOT=../..
SRC_HAL=gd

config BOARD_ATK_PANDORA
    bool
    select SOC_GD32F450ZKT6
    default y
    
source "$OS_ROOT/Kconfig"
```

## projects/hc32l176-kata/Kconfig
```kconfig
mainmenu "One-Os Configuration"

#Define the relative path to root directory of os code
OS_ROOT=../..
SRC_HAL=hc

config BOARD_HC32L1
    bool
	select SOC_HC32L176KATA
    default y
	
source "$OS_ROOT/Kconfig"
```
