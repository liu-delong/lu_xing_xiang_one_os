## projects/imxrt1052-nxp-evk/Kconfig
```kconfig
mainmenu "OneOS Configuration"

#Define the relative path to root directory of os code
OS_ROOT=../..
SRC_HAL=imxrt

config BOARD_IMXRT1052_NXP_EVK
    bool
    select SOC_IMX_MIMXRT1052
    default y
    
source "$OS_ROOT/Kconfig"
```

## projects/lpc55s69-nxp-evk/Kconfig
```kconfig
mainmenu "OneOS Configuration"

#Define the relative path to root directory of os code
OS_ROOT=../..
SRC_HAL=lpc
	
config BOARD_LPC55S69_EVK
    bool
    select SOC_LPC55S69
    select SOC_FAMILY_NXP_LPC
    select SOC_SERIES_LPC5500
    default y
	
config SOC_SERIES_LPC5500
    bool
    select ARCH_ARM_CORTEX_M33
    default n
	
source "$OS_ROOT/Kconfig"
```

## projects/mm32l373pf-miniboard/Kconfig
```kconfig
mainmenu "OneOS Configuration"

#Define the relative path to root directory of os code
OS_ROOT=../..
SRC_HAL=mm32

config BOARD_L3XX_MINI
    bool
    select SOC_MM32L3XXPF
    default y
    
source "$OS_ROOT/Kconfig"
```

## projects/stm32f103-c8t6-demo/Kconfig
```kconfig
mainmenu "OneOS Configuration"

#Define the relative path to root directory of os code
OS_ROOT=../..
SRC_HAL=st

config BOARD_C8T6_DEMO
    bool
    select SOC_STM32F103xB
    default y
    
source "$OS_ROOT/Kconfig"
```
