## drivers/hal/hc/HC32L19x_HAL/Kconfig
```kconfig
config SOC_SERIES_HC32L19
    bool
	select ARCH_ARM_CORTEX_M0
    default n
	
config SOC_HC32L196KCTA
	bool
	select SOC_FAMILY_HC32
	select SOC_SERIES_HC32L19
	default n
```

## drivers/hal/hc/Kconfig
```kconfig
config SOC_FAMILY_HC32
	bool
	default n

source "$OS_ROOT/drivers/hal/hc/HC32L13x_HAL/Kconfig"
source "$OS_ROOT/drivers/hal/hc/HC32L17x_HAL/Kconfig"
source "$OS_ROOT/drivers/hal/hc/HC32L19x_HAL/Kconfig"

source "$OS_ROOT/drivers/hal/hc/hal_drivers/Kconfig"
```

## drivers/hal/hc/hal_drivers/Kconfig
```kconfig
	config BSP_USING_GPIO
		bool "Enable GPIO"
		select OS_USING_PIN
		default y
	
	menuconfig BSP_USING_UART
		bool "Enable UART"
		default y
		select OS_USING_SERIAL
		if BSP_USING_UART
			config BSP_USING_LPUART0
				bool "Enable LPUART0"
				default y

			config BSP_USING_LPUART1
				bool "Enable LPUART1"
				default y
				
			config BSP_USING_UART0
				bool "Enable UART0"
				default y
				
			config BSP_USING_UART1
				bool "Enable UART1"
				default y

		endif
	menu "Select I2C port"
		depends on OS_USING_I2C
		config BSP_USING_I2C0
			bool "Enable I2C0"
			default y

		config BSP_USING_I2C1
			bool "Enable I2C1"
			default n
	endmenu
    menu "Select SPI port"
        depends on OS_USING_SPI
        config BSP_USING_SPI0
                bool "Enable SPI0"
                default y

        config BSP_USING_SPI1
                bool "Enable SPI1"
                default n
    endmenu

    menu "Select LPTIMER port"
        depends on OS_USING_HRTIMER
        config BSP_USING_LPTIM0
                bool "Enable LPTIM0"
                default y

        config BSP_USING_LPTIM1
                bool "Enable LPTIM1"
                default n
    endmenu

	config BSP_USING_ON_CHIP_FLASH
        bool "Enable on-chip FLASH"
        select OS_USING_FAL
        default y



		
```

## drivers/hal/imxrt/Kconfig
```kconfig
config SOC_FAMILY_IMX
    bool
    default n

source "$OS_ROOT/drivers/hal/imxrt/MIMXRT1050/Kconfig"

source "$OS_ROOT/drivers/hal/imxrt/drivers/Kconfig"
comment "Configure base hal on mcuxpresso.nxp.com"
```

## drivers/hal/imxrt/MIMXRT1050/Kconfig
```kconfig
config SOC_SERIES_MIMXRT
    bool
    select ARCH_ARM_CORTEX_M7
    default n

config SOC_IMX_MIMXRT1052
    bool
    select SOC_FAMILY_IMX
    select SOC_SERIES_MIMXRT
    default n

config SOC_IMX_MIMXRT1064
    bool
    select SOC_FAMILY_IMX
    select SOC_SERIES_MIMXRT
    default n
```

## drivers/hal/imxrt/drivers/Kconfig
```kconfig
config BSP_USING_HYPERFLASH
    bool "boot up from hyperflash"
    default n
    
config BSP_USING_QSPIFLASH
    bool "boot up from qspi flash"
    default n
    
```

## drivers/hal/ingenic/drivers/Kconfig
```kconfig
menuconfig BSP_USING_USART
    bool "Enable UART"
        default y
    select OS_USING_SERIAL
    if BSP_USING_USART
        config BSP_USING_USART0
            bool "Enable UART0"
            default n

        config BSP_USING_USART1
            bool "Enable UART1"
            default n

        config BSP_USING_USART2
            bool "Enable UART2"
            default y
    endif
```

## drivers/hal/lpc/Kconfig
```kconfig
config SOC_FAMILY_NXP_LPC
    bool
    default n

source "$OS_ROOT/drivers/hal/lpc/LPC55S69/Kconfig"

source "$OS_ROOT/drivers/hal/lpc/drivers/Kconfig"
comment "Configure base hal in MCUXpresso Config Tools"
```

## drivers/hal/lpc/LPC55S69/Kconfig
```kconfig
config SOC_SERIES_LPC5500
    bool
    select ARCH_ARM_CORTEX_M33
    default n

config SOC_LPC55S69
    bool
    select SOC_FAMILY_NXP
    select SOC_SERIES_LPC5500
    default n
```

## drivers/hal/lpc/drivers/Kconfig
```kconfig
    menuconfig BSP_USING_SPI
        bool "Enable SPI BUS"
        default n
        select OS_USING_SPI
        if BSP_USING_SPI
            config BSP_USING_SPI1
                bool "Enable SPI1 BUS"
                default n

            config BSP_SPI1_TX_USING_DMA
                bool "Enable SPI1 TX DMA"
                depends on BSP_USING_SPI1
                default n

            config BSP_SPI1_RX_USING_DMA
                bool "Enable SPI1 RX DMA"
                depends on BSP_USING_SPI1
                select BSP_SPI1_TX_USING_DMA
                default n

            config BSP_USING_SPI2
                bool "Enable SPI2 BUS"
                default n

            config BSP_SPI2_TX_USING_DMA
                bool "Enable SPI2 TX DMA"
                depends on BSP_USING_SPI2
                default n

            config BSP_SPI2_RX_USING_DMA
                bool "Enable SPI2 RX DMA"
                depends on BSP_USING_SPI2
                select BSP_SPI2_TX_USING_DMA
                default n

            config BSP_USING_SPI3
                bool "Enable SPI3 BUS"
                default n

            config BSP_SPI3_TX_USING_DMA
                bool "Enable SPI3 TX DMA"
                depends on BSP_USING_SPI3
                default n

            config BSP_SPI3_RX_USING_DMA
                bool "Enable SPI3 RX DMA"
                depends on BSP_USING_SPI3
                select BSP_SPI3_TX_USING_DMA
                default n

            config BSP_USING_SPI4
                bool "Enable SPI4 BUS"
                default n

            config BSP_SPI4_TX_USING_DMA
                bool "Enable SPI4 TX DMA"
                depends on BSP_USING_SPI4
                default n

            config BSP_SPI4_RX_USING_DMA
                bool "Enable SPI4 RX DMA"
                depends on BSP_USING_SPI4
                select BSP_SPI4_TX_USING_DMA
                default n

            config BSP_USING_SPI5
                bool "Enable SPI5 BUS"
                default n

            config BSP_SPI5_TX_USING_DMA
                bool "Enable SPI5 TX DMA"
                depends on BSP_USING_SPI5
                default n

            config BSP_SPI5_RX_USING_DMA
                bool "Enable SPI5 RX DMA"
                depends on BSP_USING_SPI5
                select BSP_SPI5_TX_USING_DMA
                default n
        endif

    menuconfig BSP_USING_INPUT_CAPTURE
        bool "Enable Input Capture"
        default n
        select OS_USING_INPUT_CAPTURE
        if BSP_USING_INPUT_CAPTURE
        menuconfig BSP_USING_INPUT_CAPTURE2
            bool "Enable timer2 Input Capture"
            default n
            if BSP_USING_INPUT_CAPTURE2
                config BSP_USING_INPUT_CAPTURE2_CH1
                    bool "Enable timer2 Input Capture channel1"
                    default n
            endif
        endif

    menuconfig BSP_USING_USBD
        bool "Enable OTGFS as USB device"
        select OS_USING_USB_DEVICE
        default n

        if BSP_USING_USBD
            config BSP_USBD_TYPE_FS
                bool "USB Full Speed (FS) Core"
                default n
            config BSP_USBD_TYPE_HS
                bool "USB High Speed (HS) Core"
                default n
            config BSP_USBD_SPEED_HS
                bool "USB High Speed (HS) Mode"
                default n
            config BSP_USBD_SPEED_HSINFS
                bool  "USB High Speed (HS) Core in FS mode"
                default n
            config BSP_USBD_PHY_EMBEDDED
                bool "Using Embedded phy interface"
                default n
            config BSP_USBD_PHY_UTMI
                bool "UTMI: USB 2.0 Transceiver Macrocell Interace"
                default n
            config BSP_USBD_PHY_ULPI
                bool "ULPI: UTMI+ Low Pin Interface"
                default n
        endif

    menuconfig BSP_USING_ETH
        bool "Enable Ethernet"
        select OS_USING_LWIP
        default n
        if BSP_USING_ETH
            comment "config eth hw"
            config ETH_RESET_PIN
            int "ETH reset pin number(default:phy_reset pin -->51)"
            range 1 176
            default 51
            choice
                prompt "choose eth hardware"
                default PHY_USING_LAN8720A
                help
                    Select the eth hardware

                config PHY_USING_LAN8720A
                    bool "LAN8720A"

                config PHY_USING_DM9161CEP
                    bool "DM9161CEP"

                config PHY_USING_DP83848C
                    bool "DP83848C"
            endchoice
        endif
```

## drivers/hal/mm32/Kconfig
```kconfig
config SOC_FAMILY_MM32
    bool
    default n

source "$OS_ROOT/drivers/hal/mm32/MM32L3xx_HAL/Kconfig"
source "$OS_ROOT/drivers/hal/mm32/drivers/Kconfig"
```

## drivers/hal/mm32/MM32L3xx_HAL/Kconfig
```kconfig
config SOC_SERIES_MM32L3
    bool
    select ARCH_ARM_CORTEX_M3
    default n

config SOC_MM32L3XXPF
    bool
    select SOC_FAMILY_MM32
    select SOC_SERIES_MM32L3
    default n
```

## drivers/hal/mt2625/Kconfig
```kconfig
config SOC_FAMILY_MT2625
    bool
    default n


source "$OS_ROOT/drivers/hal/mt2625/drivers/Kconfig"
```
