## drivers/hal/mt2625/drivers/Kconfig
```kconfig
config SOC_MT2625
    bool
    select ARCH_ARM_CORTEX_M4
    default n

config BSP_USING_GPIO
    bool "Enable GPIO"
    select OS_USING_PIN
    default y

menuconfig BSP_USING_UART
    bool "Enable UART"
    default y
    select OS_USING_SERIAL
    if BSP_USING_UART
		config BSP_USING_UART0
            bool "Enable UART0"
            default n

        config BSP_UART0_TXRX_USING_DMA
            bool "Enable UART0 TXRX DMA"
            depends on BSP_USING_UART0
            default n
			
        config BSP_USING_UART1
            bool "Enable UART1"
            default y

        config BSP_UART1_TXRX_USING_DMA
            bool "Enable UART1 TXRX DMA"
            depends on BSP_USING_UART1
            default n

        config BSP_USING_UART2
            bool "Enable UART2"
            default n

        config BSP_UART2_TXRX_USING_DMA
            bool "Enable UART2 TXRX DMA"
            depends on BSP_USING_UART2
            default n
			

        config BSP_USING_UART3
            bool "Enable UART3"
            default n

        config BSP_UART3_TXRX_USING_DMA
            bool "Enable UART3 TXRX DMA"
            depends on BSP_USING_UART3
            default n
			
    endif

config BSP_USING_ON_CHIP_FLASH
    bool "Enable on-chip FLASH"
    select PKG_USING_FAL
    default n

menuconfig BSP_USING_SPI
    bool "Enable SPI BUS"
    default n
    select OS_USING_SPI
    if BSP_USING_SPI
		config BSP_USING_SPI0
            bool "Enable SPI0 BUS"
            default n

        config BSP_SPI0_TXRX_USING_DMA
            bool "Enable SPI0 TXRX DMA"
            depends on BSP_USING_SPI0
            default n       
    endif

menuconfig BSP_USING_TIM
    bool "Enable GPT timer"
    default n
    select OS_USING_TIMER_DRIVER
    if BSP_USING_TIM
		config OS_USING_HWTIMER1
            bool "Enable GPT timer1"
            default n
			
		config OS_USING_HWTIMER2
            bool "Enable GPT timer2"
            default n
    endif

menuconfig BSP_USING_PWM
    bool "Enable PWM"
    default n
    select OS_USING_PWM	
		
    if BSP_USING_PWM
    menuconfig OS_USING_PWM0
        bool "Config PWM0"
        default n
        if OS_USING_PWM0
			choice
				prompt "Config PWM0 clock"
				default OS_PWM0_CLOCK_13MHZ

				config OS_PWM0_CLOCK_13MHZ
					bool "CLOCK_13MHZ"

				config OS_PWM0_CLOCK_32KHZ
					bool "CLOCK_32KHZ"
			endchoice
			
			config OS_PWM0_CLOCK
				int
				default 0  if OS_PWM0_CLOCK_13MHZ
				default 1  if OS_PWM0_CLOCK_32KHZ
		
            config GPIO_0_PWM0
                bool "Enable GPIO_0 to PWM0"
                default n
				
			config GPIO_1_PWM0
                bool "Enable GPIO_1 to PWM0"
                default n
				
			config GPIO_4_PWM0
                bool "Enable GPIO_4 to PWM0"
                default n
        endif

    menuconfig OS_USING_PWM1
        bool "Config PWM1"
        default n
        if OS_USING_PWM1
			choice
				prompt "Config PWM1 clock"
				default OS_PWM1_CLOCK_13MHZ

				config OS_PWM1_CLOCK_13MHZ
					bool "CLOCK_13MHZ"

				config OS_PWM1_CLOCK_32KHZ
					bool "CLOCK_32KHZ"
			endchoice
			
			config OS_PWM1_CLOCK
				int
				default 0  if OS_PWM1_CLOCK_13MHZ
				default 1  if OS_PWM1_CLOCK_32KHZ
			
            config GPIO_7_PWM1
                bool "Enable GPIO_7 to PWM1"
                default n
				
			config GPIO_8_PWM1
                bool "Enable GPIO_8 to PWM1"
                default n
        endif
		
	    menuconfig OS_USING_PWM2
        bool "Config PWM2"
        default n
        if OS_USING_PWM2
			choice
				prompt "Config PWM2 clock"
				default OS_PWM2_CLOCK_13MHZ

				config OS_PWM2_CLOCK_13MHZ
					bool "CLOCK_13MHZ"

				config OS_PWM2_CLOCK_32KHZ
					bool "CLOCK_32KHZ"
			endchoice
			
			config OS_PWM2_CLOCK
				int
				default 0  if OS_PWM2_CLOCK_13MHZ
				default 1  if OS_PWM2_CLOCK_32KHZ
		
            config GPIO_13_PWM2
                bool "Enable GPIO_13 to PWM2"
                default n
				
			config GPIO_15_PWM2
                bool "Enable GPIO_15 to PWM2"
                default n
        endif
		
		menuconfig OS_USING_PWM3
        bool "Config PWM3"
        default n
        if OS_USING_PWM3
			choice
				prompt "Config PWM3 clock"
				default OS_PWM3_CLOCK_13MHZ

				config OS_PWM3_CLOCK_13MHZ
					bool "CLOCK_13MHZ"

				config OS_PWM3_CLOCK_32KHZ
					bool "CLOCK_32KHZ"
			endchoice
			
			config OS_PWM3_CLOCK
				int
				default 0  if OS_PWM3_CLOCK_13MHZ
				default 1  if OS_PWM3_CLOCK_32KHZ
			
            config GPIO_20_PWM3
                bool "Enable GPIO_20 to PWM3"
                default n
				
			config GPIO_26_PWM3
                bool "Enable GPIO_26 to PWM3"
                default n
				
			config GPIO_32_PWM3
                bool "Enable GPIO_32 to PWM3"
                default n
        endif
    endif


menuconfig BSP_USING_ADC
    bool "Enable ADC"
    default n
    select OS_USING_ADC
    if BSP_USING_ADC
        config OS_USING_ADC0
            bool "Enable ADC0"
            default n
			
		config OS_USING_ADC1
            bool "Enable ADC1"
            default n
		
		config OS_USING_ADC2
            bool "Enable ADC2"
            default n
		
		config OS_USING_ADC3
            bool "Enable ADC3"
            default n
			
		config OS_USING_ADC4
            bool "Enable ADC4"
            default n
    endif


    config BSP_USING_DAC
    bool "Enable DAC"
    select OS_USING_DAC
    default n

config BSP_USING_ONCHIP_RTC
    bool "Enable RTC"
    select OS_USING_RTC
    default n

config BSP_USING_WDG
    bool "Enable Watchdog Timer"
    select OS_USING_WDG
    default n

menuconfig BSP_USING_CAN
    bool "Enable CAN"
    select OS_USING_CAN
    default n
    if BSP_USING_CAN
        choice
            prompt "Select CAN"
            default BSP_USING_CAN1

            config BSP_USING_CAN1
                bool "USING CAN1"

            config BSP_USING_CAN2
                bool "USING CAN2"
        endchoice
    endif

menuconfig BSP_USING_SAI
    bool "Enable SAI"
    select OS_USING_AUDIO
    default n
    if BSP_USING_SAI
        config BSP_USING_SAI1
            bool "Enable SAI1"
            default n
        config BSP_USING_SAI2
            bool "Enable SAI2"
            default n
    endif

config BSP_USING_SDIO
    bool "Enable SDIO"
    select OS_USING_SDIO
    default n

menuconfig BSP_USING_USBD
    bool "Enable OTGFS as USB device"
    select OS_USING_USB_DEVICE
    default n

    if BSP_USING_USBD
        config BSP_USBD_TYPE_FS
            bool "USB Full Speed (FS) Core"
            default n
        config BSP_USBD_TYPE_HS
            bool "USB High Speed (HS) Core"
            default n
        config BSP_USBD_SPEED_HS
            bool "USB High Speed (HS) Mode"
            default n
        config BSP_USBD_SPEED_HSINFS
            bool  "USB High Speed (HS) Core in FS mode"
            default n
        config BSP_USBD_PHY_EMBEDDED
            bool "Using Embedded phy interface"
            default n
        config BSP_USBD_PHY_UTMI
            bool "UTMI: USB 2.0 Transceiver Macrocell Interace"
            default n
        config BSP_USBD_PHY_ULPI
            bool "ULPI: UTMI+ Low Pin Interface"
            default n
    endif

config BSP_USING_CRC
    bool "Enable CRC (CRC-32 0x04C11DB7 Polynomial)"
    select OS_USING_HWCRYPTO
    select OS_HWCRYPTO_USING_CRC
    # "Crypto device frame dose not support above 8-bits granularity"
    # "Reserve progress, running well, about 32-bits granularity, such as stm32f1, stm32f4"
    depends on (SOC_SERIES_STM32L4 || SOC_SERIES_STM32F0 || SOC_SERIES_STM32F4 ||SOC_SERIES_STM32F7 || SOC_SERIES_STM32H7)
    default n

config BSP_USING_RNG
    bool "Enable RNG (Random Number Generator)"
    select OS_USING_HWCRYPTO
    select OS_HWCRYPTO_USING_RNG
    depends on (SOC_SERIES_STM32L4 || SOC_SERIES_STM32F4 || SOC_SERIES_STM32F7 || \
                SOC_SERIES_STM32H7)
    default n

config BSP_USING_UDID
    bool "Enable UDID (Unique Device Identifier)"
    select OS_USING_HWCRYPTO
    default n

config BSP_USING_SDRAM
    bool "Enable SDRAM"
    default n

menuconfig BSP_USING_LTDC
    bool "Enable LTDC"
    default n

    if BSP_USING_LTDC
        config BSP_USING_LTDC_MIPI
            bool "Enable MIPI"
            default n
                if BSP_USING_LTDC_MIPI
                    config BSP_LTDC_MIPI_RST
                        int "mipi dsi rst io"
                        default 159
                endif

        config BSP_LCD_WIDTH
            int "Lcd width"
            default 320

        config BSP_LCD_HEIGHT
            int "Lcd height"
            default 240
    endif

config BSP_USING_SRAM
    bool "Enable SRAM"
    select BSP_USING_EXT_FMC_IO
    select BSP_USING_FMC
    depends on (SOC_SERIES_STM32F4)
    default n
    config BSP_USING_EXT_FMC_IO
    bool
    default n
    config BSP_USING_FMC
    bool


menuconfig BSP_USING_ETH
    bool "Enable Ethernet"
    select NET_USING_LWIP
    default n
    if BSP_USING_ETH
        comment "config eth hw"
        config ETH_RESET_PIN
        int "ETH reset pin number(default:phy_reset pin -->51)"
        range 1 176
        default 51
        choice
            prompt "choose eth hardware"
            default PHY_USING_LAN8720A
            help
                Select the eth hardware

            config PHY_USING_LAN8720A
                bool "LAN8720A"

            config PHY_USING_DM9161CEP
                bool "DM9161CEP"

            config PHY_USING_DP83848C
                bool "DP83848C"
        endchoice
    endif
```

## drivers/hal/nordic/Kconfig
```kconfig
config SOC_SERIES_NRF52
    bool
    select ARCH_ARM_CORTEX_M4
    default n

config SOC_NRF52840_XXAA
    bool
    select SOC_FAMILY_NRF
    select SOC_SERIES_NRF52
    default n
```

## drivers/hal/st/Kconfig
```kconfig
config SOC_FAMILY_STM32
    bool
    default n

source "$OS_ROOT/drivers/hal/st/STM32F0xx_HAL/Kconfig"
source "$OS_ROOT/drivers/hal/st/STM32F1xx_HAL/Kconfig"
source "$OS_ROOT/drivers/hal/st/STM32F3xx_HAL/Kconfig"
source "$OS_ROOT/drivers/hal/st/STM32F4xx_HAL/Kconfig"
source "$OS_ROOT/drivers/hal/st/STM32F7xx_HAL/Kconfig"
source "$OS_ROOT/drivers/hal/st/STM32G0xx_HAL/Kconfig"
source "$OS_ROOT/drivers/hal/st/STM32H7xx_HAL/Kconfig"
source "$OS_ROOT/drivers/hal/st/STM32L0xx_HAL/Kconfig"
source "$OS_ROOT/drivers/hal/st/STM32L1xx_HAL/Kconfig"
source "$OS_ROOT/drivers/hal/st/STM32L4xx_HAL/Kconfig"

source "$OS_ROOT/drivers/hal/st/drivers/Kconfig"
comment "Configure base hal in STM32CubeMX"
```

## drivers/hal/st/STM32F0xx_HAL/Kconfig
```kconfig
config SOC_SERIES_STM32F0
    bool
    select ARCH_ARM_CORTEX_M0
    default n

config SOC_STM32F0XXX
    bool
    select SOC_FAMILY_STM32
    select SOC_SERIES_STM32F0
    default n

config SOC_STM32F030xC
    bool
    select SOC_FAMILY_STM32
    select SOC_SERIES_STM32F0
    default n

config SOC_STM32F091xC
    bool
    select SOC_FAMILY_STM32
    select SOC_SERIES_STM32F0
    default n
```

## drivers/hal/st/STM32F1xx_HAL/Kconfig
```kconfig
config SOC_SERIES_STM32F1
    bool
    select ARCH_ARM_CORTEX_M3
    default n

config SOC_STM32F1XX
    bool
    select SOC_FAMILY_STM32
    select SOC_SERIES_STM32F1
    default n

config SOC_STM32F103xB
    bool
    select SOC_FAMILY_STM32
    select SOC_SERIES_STM32F1
    default n


config SOC_STM32F103xE
    bool
    select SOC_FAMILY_STM32
    select SOC_SERIES_STM32F1
    default n
```

## drivers/hal/st/STM32F3xx_HAL/Kconfig
```kconfig
config SOC_SERIES_STM32F3
    bool
    select ARCH_ARM_CORTEX_M4
    default n

config SOC_STM32F3XX
    bool
    select SOC_FAMILY_STM32
    select SOC_SERIES_STM32F3
    default n
```

## drivers/hal/st/STM32F4xx_HAL/Kconfig
```kconfig
config SOC_SERIES_STM32F4
    bool
    select ARCH_ARM_CORTEX_M4
    default n

config SOC_STM32F4XX
    bool
    select SOC_FAMILY_STM32
    select SOC_SERIES_STM32F4
    default n

config SOC_STM32F429xx
    bool
    select SOC_FAMILY_STM32
    select SOC_SERIES_STM32F4
    default n

config SOC_STM32F407xx
    bool
    select SOC_FAMILY_STM32
    select SOC_SERIES_STM32F4
    default n

config SOC_STM32F405xx
    bool
    select SOC_FAMILY_STM32
    select SOC_SERIES_STM32F4
    default n

config SOC_STM32F469xx
    bool
    select SOC_FAMILY_STM32
    select SOC_SERIES_STM32F4
    default n
```

## drivers/hal/st/STM32F7xx_HAL/Kconfig
```kconfig
config SOC_SERIES_STM32F7
    bool
    select ARCH_ARM_CORTEX_M7
    default n

config SOC_STM32F722xx
    bool
    select SOC_FAMILY_STM32
    select SOC_SERIES_STM32F7
    default n


config SOC_STM32F746xx
    bool
    select SOC_FAMILY_STM32
    select SOC_SERIES_STM32F7
    default n

config SOC_STM32F767xx
    bool
    select SOC_FAMILY_STM32
    select SOC_SERIES_STM32F7
    default n

config SOC_STM32F769xx
    bool
    select SOC_FAMILY_STM32
    select SOC_SERIES_STM32F7
    default n
```

## drivers/hal/st/STM32G0xx_HAL/Kconfig
```kconfig
config SOC_SERIES_STM32G0
    bool
    select ARCH_ARM_CORTEX_M0
    default n

config SOC_STM32G0XX
    bool
    select SOC_FAMILY_STM32
    select SOC_SERIES_STM32G0
    default n

config SOC_STM32G071RB
    bool
    select SOC_FAMILY_STM32
    select SOC_SERIES_STM32G0
    default n
```

## drivers/hal/st/STM32H7xx_HAL/Kconfig
```kconfig
config SOC_SERIES_STM32H7
    bool
    default n

config SOC_SERIES_STM32H7_M4
    bool
    select SOC_SERIES_STM32H7
    select ARCH_ARM_CORTEX_M4
    default n

config SOC_SERIES_STM32H7_M7
    bool
    select SOC_SERIES_STM32H7
    select ARCH_ARM_CORTEX_M7
    default n

config SOC_STM32H743xx
    bool
    select SOC_FAMILY_STM32
    select SOC_SERIES_STM32H7_M7
    default n

config SOC_STM32H747XI_CM7
    bool
    select SOC_FAMILY_STM32
    select SOC_SERIES_STM32H7_M7
    default n

config SOC_STM32H747XI_CM4
    bool
    select SOC_FAMILY_STM32
    select SOC_SERIES_STM32H7_M4
    default n

config SOC_STM32H750xx
    bool
    select SOC_FAMILY_STM32
    select SOC_SERIES_STM32H7_M7
    default n
```

## drivers/hal/st/STM32L0xx_HAL/Kconfig
```kconfig
config SOC_SERIES_STM32L0
    bool
    select ARCH_ARM_CORTEX_M0
    default n

config SOC_STM32L0XX
    bool
    select SOC_FAMILY_STM32
    select SOC_SERIES_STM32L0
    default n

config SOC_STM32L053R8
    bool
    select SOC_FAMILY_STM32
    select SOC_SERIES_STM32L0
    default n
	
config SOC_STM32L051XX
    bool
	select SOC_FAMILY_STM32
	select SOC_SERIES_STM32L0
    default n
```

## drivers/hal/st/STM32L1xx_HAL/Kconfig
```kconfig
config SOC_SERIES_STM32L1
    bool
    select ARCH_ARM_CORTEX_M3
    default n

config SOC_STM32L1XX
    bool
    select SOC_FAMILY_STM32
    select SOC_SERIES_STM32L1
    default n

config SOC_STM32L152RE
    bool
    select SOC_FAMILY_STM32
    select SOC_SERIES_STM32L1
    default n
```
