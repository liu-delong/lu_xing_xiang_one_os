## components/net/molink/Kconfig
```kconfig
menu "Molink"

config NET_USING_MOLINK
    bool "Enable IoT modules support"
    default n

if NET_USING_MOLINK

    source "$OS_ROOT/components/net/molink/core/Kconfig"

    source "$OS_ROOT/components/net/molink/module/Kconfig"

    source "$OS_ROOT/components/net/molink/parser/Kconfig"

    source "$OS_ROOT/components/net/molink/api/Kconfig"

endif

endmenu 
```

## components/net/molink/api/Kconfig
```kconfig
config MOLINK_USING_GENERAL_OPS
    bool
    default n

config MOLINK_USING_NETSERV_OPS
    bool
    default n

config MOLINK_USING_PING_OPS
    bool
    select MOLINK_USING_IP
    default n

config MOLINK_USING_IFCONFIG_OPS
    bool
    select MOLINK_USING_IP
    default n

config MOLINK_USING_NETCONN_OPS
    bool
    select OS_USING_DATAQUEUE
    select MOLINK_USING_IP
    default n

config MOLINK_USING_SOCKETS_OPS
    bool
    select MOLINK_USING_NETCONN_OPS
    default n

config MOLINK_USING_ONENET_NB_OPS
    bool
    select MOLINK_USING_IP
    default n

config MOLINK_USING_WIFI_OPS
    bool
    default n

config MOLINK_USING_IP
    bool
    default n

    if MOLINK_USING_IP
        config MOLINK_USING_IPV4
        bool
        default y
    endif
```

## components/net/molink/module/Kconfig
```kconfig
menu "Modules"

menu "4G CAT1 Modules Support" 

    config MOLINK_USING_EC200X
        bool "EC200X"
        select MOLINK_PLATFORM_MCU
        default n
        
        if MOLINK_USING_EC200X
            source "$OS_ROOT/components/net/molink/module/ec200x/Kconfig"
        endif

    config MOLINK_USING_ML302
        bool "ML302"
        select MOLINK_PLATFORM_MCU
        default n
        
        if MOLINK_USING_ML302
            source "$OS_ROOT/components/net/molink/module/ml302/Kconfig"
        endif

    config MOLINK_USING_GM190
        bool "GM190"
        select MOLINK_PLATFORM_MCU
        default n
        
        if MOLINK_USING_GM190
            source "$OS_ROOT/components/net/molink/module/gm190/Kconfig"
        endif

    config MOLINK_USING_A7600X
        bool "A7600X"
        select MOLINK_PLATFORM_MCU
        default n

        if MOLINK_USING_A7600X
            source "$OS_ROOT/components/net/molink/module/a7600x/Kconfig"
        endif

    config MOLINK_USING_L610
        bool "L610"
        select MOLINK_PLATFORM_MCU
        default n
        
        if MOLINK_USING_L610
            source "$OS_ROOT/components/net/molink/module/l610/Kconfig"
        endif
endmenu

menu "4G CAT4 Modules Support" 

    config MOLINK_USING_GM510
        bool "GM510"
        select MOLINK_PLATFORM_MCU
        default n
        
        if MOLINK_USING_GM510
            source "$OS_ROOT/components/net/molink/module/gm510/Kconfig"
        endif
endmenu

menu "NB-IOT Modules Support" 

    config MOLINK_USING_M5310A
        bool "M5310A"
        select MOLINK_PLATFORM_MCU
        default n
        
        if MOLINK_USING_M5310A
            source "$OS_ROOT/components/net/molink/module/m5310a/Kconfig"
        endif

    config MOLINK_USING_M5311
        bool "M5311"
        select MOLINK_PLATFORM_MCU
        default n
        
        if MOLINK_USING_M5311
            source "$OS_ROOT/components/net/molink/module/m5311/Kconfig"
        endif

    config MOLINK_USING_BC95
        bool "BC95"
        select MOLINK_PLATFORM_MCU
        default n
        
        if MOLINK_USING_BC95
            source "$OS_ROOT/components/net/molink/module/bc95/Kconfig"
        endif

    config MOLINK_USING_BC28
        bool "BC28"
        select MOLINK_PLATFORM_MCU
        default n
        
        if MOLINK_USING_BC28
            source "$OS_ROOT/components/net/molink/module/bc28/Kconfig"
        endif

    config MOLINK_USING_SIM7020
        bool "SIM7020"
        select MOLINK_PLATFORM_MCU
        default n
        
        if MOLINK_USING_SIM7020
            source "$OS_ROOT/components/net/molink/module/sim7020/Kconfig"
        endif

endmenu

menu "WiFi Modules Support" 

    config MOLINK_USING_ESP8266
        bool "ESP8266"
        select MOLINK_PLATFORM_MCU
        default n
        
        if MOLINK_USING_ESP8266
            source "$OS_ROOT/components/net/molink/module/esp8266/Kconfig"
        endif

    config MOLINK_USING_ESP32
        bool "ESP32"
        select MOLINK_PLATFORM_MCU
        default n
        
        if MOLINK_USING_ESP32
            source "$OS_ROOT/components/net/molink/module/esp32/Kconfig"
        endif

endmenu

endmenu
```

## components/net/molink/module/bc28/Kconfig
```kconfig
menu "BC28 Config" 

    config BC28_AUTO_CREATE
        bool "Enable BC28 Module Object Auto Create"
        select MOLINK_USING_AUTO_CREATE
        default n

    if BC28_AUTO_CREATE

        config BC28_DEVICE_NAME
            string "BC28 Interface Device Name"
            default "uart1"

        config BC28_DEVICE_RATE
            int "BC28 Interface Device Rate"
            default 9600

        config BC28_RECV_BUFF_LEN
            int "The maximum length of AT command data accepted"
            default 512

    endif

    config BC28_USING_GENERAL_OPS
        bool "Enable BC28 Module General Operates"
        select MOLINK_USING_GENERAL_OPS
        default y
    
    config BC28_USING_NETSERV_OPS
        bool "Enable BC28 Module Network Service Operates"
        select MOLINK_USING_NETSERV_OPS
        default y

    config BC28_USING_NETCONN_OPS
        bool "Enable BC28 Module Network TCP/IP Operates"
        select MOLINK_USING_NETCONN_OPS
        select BC28_USING_NETSERV_OPS
        default y

    config BC28_USING_SOCKETS_OPS
        bool "Enable BC28 Module BSD Socket Operates"
        select BC28_USING_NETCONN_OPS
        select MOLINK_USING_SOCKETS_OPS
        default n

    config BC28_USING_ONENET_NB_OPS
        bool "Enable BC28 Module Onenet Nb Operates"
        select MOLINK_USING_ONENET_NB_OPS
        default y

endmenu
```

## components/net/molink/module/ec200x/Kconfig
```kconfig
menu "EC200X Config" 

    config EC200X_AUTO_CREATE
        bool "Enable EC200X Module Object Auto Create"
        default n

    if EC200X_AUTO_CREATE

        config EC200X_DEVICE_NAME
            string "EC200X Interface Device Name"
            default "uart2"

        config EC200X_DEVICE_RATE
            int "EC200X Interface Device Rate"
            default 115200

        config EC200X_RECV_BUFF_LEN
            int "The maximum length of AT command data accepted"
            default 512

    endif

    config EC200X_USING_GENERAL_OPS
        bool "Enable EC200X Module General Operates"
        select MOLINK_USING_GENERAL_OPS
        default y
    
    config EC200X_USING_NETSERV_OPS
        bool "Enable EC200X Module Network Service Operates"
        select MOLINK_USING_NETSERV_OPS
        default y

    config EC200X_USING_NETCONN_OPS
        bool "Enable EC200X Module Network TCP/IP Operates"
        select OS_USING_EVENT
        select MOLINK_USING_NETCONN_OPS
        default y

    config EC200X_USING_SOCKETS_OPS
        bool "Enable EC200X Module BSD Socket Operates"
        select EC200X_USING_NETCONN_OPS
        select MOLINK_USING_SOCKETS_OPS
        default n

endmenu
```

## components/net/molink/module/gm510/Kconfig
```kconfig
menu "GM510 Config" 

    config GM510_AUTO_CREATE
        bool "Enable GM510 Module Object Auto Create"
        default n

    if GM510_AUTO_CREATE

        config GM510_DEVICE_NAME
            string "GM510 Interface Device Name"
            default "uart2"

        config GM510_DEVICE_RATE
            int "GM510 Interface Device Rate"
            default 115200

        config GM510_RECV_BUFF_LEN
            int "The maximum length of AT command data accepted"
            default 512

    endif

    config GM510_USING_GENERAL_OPS
        bool "Enable GM510 Module General Operates"
        select MOLINK_USING_GENERAL_OPS
        default y

endmenu
```

## components/net/molink/parser/Kconfig
```kconfig
menu "Parser"

config MOLINK_USING_PARSER
    bool "Enable AT Parser"
    default n

if MOLINK_USING_PARSER
        config AT_PARSER_TASK_STACK_SIZE
            int "The AT Parser task stack size"
            default 2048

        config AT_PARSER_PRINT_RAW
            bool "Enable print RAW format AT command communication data"
            default n
            select DLOG_USING_ISR_LOG if OS_USING_DLOG 

        config AT_CMD_LEN_MAX
            int "The maximum lenght of AT commands buffer"

            default 128 

endif

endmenu
```

## components/net/ota/cmiot/Kconfig
```kconfig
menu "Fota by CMIOT"
    
    config FOTA_USING_CMIOT
        bool "Enable fota by cmiot"
        default n
        select NET_USING_BSD
        select OS_USING_FAL

    if FOTA_USING_CMIOT
        
        choice
        prompt "The supported network protocol"
        default CMIOT_NETWORKING_MODE_COAP
        config CMIOT_NETWORKING_MODE_COAP
            bool "Coap"
        config CMIOT_NETWORKING_MODE_HTTP
            bool "Http"
        endchoice

        config CMIOT_DEFAULT_NETWORK_PROTOCOL
            int
            default 1  if CMIOT_NETWORKING_MODE_COAP
            default 2 if CMIOT_NETWORKING_MODE_HTTP
        
        choice
        prompt "The supported algorithm"
        default CMIOT_ALGORITHM_LUSUN
        config CMIOT_ALGORITHM_LUSUN
            bool "Lusun"
        config CMIOT_ALGORITHM_WOSUN
            bool "Wosun low"
        config CMIOT_ALGORITHM_WOSUN_HIGH
            bool "Wosun high"
        endchoice

        config CMIOT_FOTA_ALGORITHM
            int
            default 0  if CMIOT_ALGORITHM_LUSUN
            default 1 if CMIOT_ALGORITHM_WOSUN
            default 2 if CMIOT_ALGORITHM_WOSUN_HIGH

        config CMIOT_DEFAULT_SECTOR_SIZE
            hex
            default 0x800  if SOC_SERIES_STM32F0
            default 0x800 if SOC_SERIES_STM32F1
            default 0x20000 if SOC_SERIES_STM32F2
            default 0x800 if SOC_SERIES_STM32F3
            default 0x20000 if SOC_SERIES_STM32F4
            default 0x40000 if SOC_SERIES_STM32F7
            default 0x20000 if SOC_SERIES_STM32H7
            default 0x100 if SOC_SERIES_STM32L1
            default 0x800 if SOC_SERIES_STM32L4
            default 0x800 if SOC_SERIES_STM32G0

        if CMIOT_ALGORITHM_WOSUN || CMIOT_ALGORITHM_WOSUN_HIGH

            config CMIOT_FLASH_APP_ADDR
                hex "App part addr from fal's OS_APP_PART_ADDR"
                default 0x8010000

            config CMIOT_UPDATE_SIZE
                hex "Download part size from fal's OS_DL_PART_SIZE"
                default 0x30000

        endif

        config CMIOT_FOTA_WOSUN_VERSION
            string "Wosun version"
            default "IOT4.0_R42641"
        
        config CMIOT_FOTA_LUSUN_VERSION
            string "Lun version"
            default "IOT5.0_LUSUN11_R50426"
        
        config CMIOT_DEFAULT_SEGMENT_SIZE_INDEX
            int "Segment size index"
            range 0 5
            default 3
        
        config CMIOT_FOTA_SERVICE_OEM
            string "Oem"
            default "cmiot_cd"
        
        config CMIOT_FOTA_SERVICE_MODEL
            string "Model"
            default "L475RE"
        
        config CMIOT_FOTA_SERVICE_PRODUCT_ID
            string "Product id"
            default "1571101950"
        
        config CMIOT_FOTA_SERVICE_PRODUCT_SEC
            string "Product secret"
            default "c36b6a45f78546e1a11390a90ee7f158"
        
        config CMIOT_FOTA_SERVICE_DEVICE_TYPE
            string "Device type"
            default "box"
        
        config CMIOT_FOTA_SERVICE_PLATFORM
            string "Platform"
            default "stm32l4"
        
        config CMIOT_FIRMWARE_VERSION
            string "Firmware version"
            default "1.0"
        
        config CMIOT_FOTA_APP_VERSION
            string "App Version"
            default "CMIOT_V4.0"
        
        config CMIOT_FOTA_OS_VERSION
            string "OS version"
            default "ONEOS_V1.0"
        
    endif

endmenu
```

## components/net/protocols/Kconfig
```kconfig
menu "Protocols"

source "$OS_ROOT/components/net/protocols/libcoap-4.2.1/Kconfig"
source "$OS_ROOT/components/net/protocols/pahomqtt-v1.1.0/Kconfig"
source "$OS_ROOT/components/net/protocols/websocket/Kconfig"
source "$OS_ROOT/components/net/protocols/httpclient/Kconfig"

endmenu
```

## components/net/protocols/httpclient/Kconfig
```kconfig
menu "Httpclient"

config NET_USING_HTTPCLIENT
	bool "Enable Httpclient"
	select NET_USING_BSD
	default n
    
    if NET_USING_HTTPCLIENT
		
		config CONFIG_HTTP_SECURE
            bool "Enable Httpclient TLS encrypt"
			select SECURITY_USING_MBEDTLS
            default n
			
		config HTTPCLIENT_USING_SAMPLE
            bool "Enable HTTPCLIENT sample"
            default n 
		
		config CONFIG_HTTP_RECV_TIMEOUT_MS
			int "HTTP SET RECV TIMEOUT MS"
			default 5000
    endif
	
endmenu
```

## components/net/protocols/libcoap-4.2.1/Kconfig
```kconfig
menu "CoAP"

config NET_USING_COAP
    bool "Enable libCoAP: A C implementation of the CoAP(RFC 7252)"
    select NET_USING_BSD
    select BSP_USING_ONCHIP_RTC
    select PKG_USING_NTP
    select OS_USING_RTC
    default n

	help
		A C implementation of the CoAP(RFC 7252)

if NET_USING_COAP
	config NET_USING_COAP_EXAMPLE
	bool "Enable libCoAP example"
	default y

endif

endmenu 
```
