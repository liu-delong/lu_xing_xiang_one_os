## Kconfig
```kconfig
source "$OS_ROOT/arch/Kconfig"
source "$OS_ROOT/kernel/Kconfig"
source "$OS_ROOT/libc/Kconfig"
source "$OS_ROOT/osal/Kconfig"
source "$OS_ROOT/drivers/Kconfig"
source "$OS_ROOT/components/Kconfig"
source "$OS_ROOT/thirdparty/Kconfig"

menu "Boot Config"
    config OS_USE_BOOTLOADER
	    bool "Enable OneOS bootloader"
		default n
        help
            Use the OneOS bootloader and FOTA components
endmenu

menu "Debug"

    config OS_DEBUG
        bool "Enable debug"
        default y
        help
            dlog and kernel log depends on this switch
    if OS_DEBUG
        config OS_DEBUG_LOG_WITH_FUNC_LINE
            bool "Enable debug log with function name and line number"
            default y
    endif
    
    choice
        prompt "The log buffer size"
        default LOG_BUFF_SIZE_256
        help
            The temporary log buffer size for dlog, os_kprintf() and os_kernel_log()
        
        config LOG_BUFF_SIZE_128
            bool "128"
        config LOG_BUFF_SIZE_192
            bool "192"
        config LOG_BUFF_SIZE_256
            bool "256"
        config LOG_BUFF_SIZE_384
            bool "384" 
    endchoice
    config OS_LOG_BUFF_SIZE
        int
        default 128 if LOG_BUFF_SIZE_128
        default 192 if LOG_BUFF_SIZE_192
        default 256 if LOG_BUFF_SIZE_256
        default 384 if LOG_BUFF_SIZE_384
         
endmenu


        
```

## arch/arm/Kconfig
```kconfig
config ARCH_ARM
    bool

config ARCH_ARM_CORTEX_M
    bool
    select ARCH_ARM

config ARCH_ARM_CORTEX_M0
    bool
    select ARCH_ARM_CORTEX_M

config ARCH_ARM_CORTEX_M3
    bool
    select ARCH_ARM_CORTEX_M

config ARCH_ARM_CORTEX_M4
    bool
    select ARCH_ARM_CORTEX_M

config ARCH_ARM_CORTEX_M7
    bool
    select ARCH_ARM_CORTEX_M

config ARCH_ARM_CORTEX_M33
    bool
    select ARCH_ARM_CORTEX_M
```

## arch/xtensa/Kconfig
```kconfig
config ARCH_XTENSA
    bool

config ARCH_XTENSA_LX6
    bool
    select ARCH_XTENSA
```

## components/Kconfig
```kconfig
menu "Components"
    source "$OS_ROOT/components/atest/Kconfig"
    source "$OS_ROOT/components/cloud/Kconfig"
    source "$OS_ROOT/components/dlog/Kconfig"
    source "$OS_ROOT/components/net/Kconfig"
    source "$OS_ROOT/components/security/Kconfig"
    source "$OS_ROOT/components/shell/Kconfig"
    source "$OS_ROOT/components/fs/Kconfig"
    source "$OS_ROOT/components/gui/Kconfig"
    source "$OS_ROOT/components/ramdisk/Kconfig"
    source "$OS_ROOT/components/diagnose/Kconfig"
endmenu
```

## components/atest/Kconfig
```kconfig
menu "Atest"
    config OS_USING_ATEST
        bool "Enable atest"
        default y
        select OS_USING_SHELL
        select OS_USING_DLOG

    if OS_USING_ATEST
        config ATEST_TASK_STACK_SIZE
            int "The atest task stack size"
            default 4096
        config ATEST_TASK_PRIORITY
            int "The atest task priority"
            default 20
    endif
endmenu
```

## components/cloud/onenet/mqtt-kit/Kconfig
```kconfig
menu "MQTT kit"

config OS_USING_ONENET_MQTTS
    bool "Enable onenet mqtt-kit"
    select NET_USING_PAHO_MQTT
    select PKG_USING_CJSON
    select NET_USING_BSD
    default n
    
    if OS_USING_ONENET_MQTTS
		
        config ONENET_MQTTS_USING_AUTO_REGISTER
            bool "Enable onenet device auto register"
            default n       
			
        config ONENET_MQTTS_USING_TLS
            bool "Enable mqtt-kit TLS encrypt"
            select MQTT_USING_TLS
            default n         
         
    endif
    
endmenu
```

## components/cloud/onenet/nbiot-kit/Kconfig
```kconfig
menu "NB-IoT kit"

config OS_USING_ONENET_NBIOT
    bool "Enable onenet nbiot-kit"
    select BSP_USING_ONCHIP_RTC
    select OS_USING_RTC
    select NET_USING_BSD
	default n
    
    if OS_USING_ONENET_NBIOT
		
		config ONENET_NBIOT_USING_AUTH_CODE
            bool "Using nbiot-kit device auth code"
            default n
			
			if ONENET_NBIOT_USING_AUTH_CODE
				config NBIOT_DEVICE_AUTH_CODE
				string "Input device auth code"
				default ""
			endif
		
		config ONENET_NBIOT_ENABLE_LOG
            bool "Enable onenet nbiot-kit log"
            default y  
			
            if ONENET_NBIOT_ENABLE_LOG
                config ONENET_NBIOT_LOG_LEVEL
                int "Log output level"
                default 3
				
                config ONENET_NBIOT_LOG_BUFFER_SIZE
                int "Log buffer size"
                default 200
            endif
			
        config ONENET_NBIOT_ENABLE_MEMTRACE
            bool "Enable onenet nbiot-kit memtrace"
            default n 
			
		config ONENET_NBIOT_USING_SAMPLE
            bool "Enable onenet nbiot-kit sample"
            default y 
    endif
	
endmenu
```

## components/diagnose/Kconfig
```kconfig
menu "Diagnose"
	config OS_USING_CPU_USAGE
		bool "Calculate CPU usage"
		default n
	
	config OS_USING_TASK_MONITOR
		bool "Task monitor"
		default n
		
	if OS_USING_TASK_MONITOR
		config OS_USING_TASK_PERIOD_MONITOR
			bool "Periodic task monitoring"
			default n
			
		config OS_USING_TASK_SWITCH_MONITOR
			bool "Task switching monitoring"
			default n
	endif


	config STACK_TRACE_EN
		bool "Stack back trace enable"
		default n

	if STACK_TRACE_EN
		config EXC_DUMP_STACK
			bool "back trace dump stack"
			default n
		config TASK_STACK_OVERFLOW_STACK_SIZE
			int "The stack overflow back trace size"
			default 256	
			
		config CALL_BACK_TRACE_MAX_DEPTH
			int "The stack back trace max depth"
			default 10				
	endif
endmenu	
```

## components/dlog/Kconfig
```kconfig
menu "Dlog"
    config OS_USING_DLOG
    bool "Enable dlog"
    default y
    
    if OS_USING_DLOG
        config DLOG_USING_SYSLOG
            bool "Enable syslog"
            default n
    
        if !DLOG_USING_SYSLOG
            choice
                prompt "The global output log level."
                default DLOG_OUTPUT_LVL_W
                help
                    When the log level is less than this option and it will stop output.

                config DLOG_OUTPUT_LVL_E
                    bool "Error"
                config DLOG_OUTPUT_LVL_W
                    bool "Warning"
                config DLOG_OUTPUT_LVL_I
                    bool "Information"
                config DLOG_OUTPUT_LVL_D
                    bool "Debug"
            endchoice
        endif

        if DLOG_USING_SYSLOG
            choice
                prompt "The global output log level."
                default DLOG_OUTPUT_LVL_WARNING
                help
                    When the log level is less than this option and it will stop output.
                    
                config DLOG_OUTPUT_LVL_EMERG
                    bool "EMERG"
                config DLOG_OUTPUT_LVL_ALERT
                    bool "ALERT"
                config DLOG_OUTPUT_LVL_CRIT
                    bool "CRIT"
                config DLOG_OUTPUT_LVL_ERROR
                    bool "ERROR"
                config DLOG_OUTPUT_LVL_WARNING
                    bool "WARNING"
                config DLOG_OUTPUT_LVL_NOTICE
                    bool "NOTICE"
                config DLOG_OUTPUT_LVL_INFO
                    bool "INFOMATION"
                config DLOG_OUTPUT_LVL_DEBUG
                    bool "DEBUG"
            endchoice
        endif
        
        config DLOG_GLOBAL_LEVEL
            int
            default 0 if DLOG_OUTPUT_LVL_EMERG
            default 1 if DLOG_OUTPUT_LVL_ALERT
            default 2 if DLOG_OUTPUT_LVL_CRIT
            default 3 if DLOG_OUTPUT_LVL_E
            default 3 if DLOG_OUTPUT_LVL_ERROR
            default 4 if DLOG_OUTPUT_LVL_W
            default 4 if DLOG_OUTPUT_LVL_WARNING
            default 5 if DLOG_OUTPUT_LVL_NOTICE
            default 6 if DLOG_OUTPUT_LVL_I
            default 6 if DLOG_OUTPUT_LVL_INFO
            default 7 if DLOG_OUTPUT_LVL_D
            default 7 if DLOG_OUTPUT_LVL_DEBUG

        config DLOG_USING_ISR_LOG
            bool "Enable ISR log."
            default n
            help
                The log output API can be used in ISR (Interrupt Service Routines) also.

        config DLOG_USING_ASYNC_OUTPUT
            bool "Enable async output mode."
            default n
            help
                When enable asynchronous output mode. The log output is not immediately and the log will stored to buffer.
                The another task will read the buffer and output the log. So it will use more RAM.

        if DLOG_USING_ASYNC_OUTPUT
            config DLOG_ASYNC_OUTPUT_BUF_SIZE
                int "The async output buffer size."
                default 2048

            config DLOG_ASYNC_OUTPUT_TASK_STACK
                int "The async output task stack size."
                default 2048

            config DLOG_ASYNC_OUTPUT_TASK_PRIORITY
                int "The async output task stack priority."
                range 0 OS_TASK_PRIORITY_MAX
                default 30
        endif
			
		menu "Dlog backend option"
			
			config DLOG_BACKEND_USING_CONSOLE
				bool "Enable console backend."
				default y
				help
					The low level output using os_kprintf().

			config DLOG_BACKEND_USING_FILESYSTEM
				bool "Enable dlog backend use filesystem to record."
				default n
				select DLOG_USING_ASYNC_OUTPUT
				select DLOG_BACKEND_USING_CONSOLE
				help
					When enable dlog using filesystem mode. The log output will be record in filesystem as file.

				if DLOG_BACKEND_USING_FILESYSTEM											
					config DLOG_FILE_DIR
						string "The record file path."
						default "/dlog/"
						
					config DLOG_FILE_NAME
						string "The record file name."
						default "log.txt"
						
					config DLOG_FILE_SIZE
						int "The record file size."
						default 2048
				
					config DLOG_FILE_NUM
						int "The record file number."
						default 5
					
				endif
		endmenu		
		
        config DLOG_USING_FILTER
            bool "Enable runtime log filter."
            default y
            help
                It will enable the log filter.
                Such as log tag filter, log keyword filter and tag's level filter.

        menu "Log format"
            config DLOG_OUTPUT_FLOAT
                bool "Enable float number support. It will use more task stack."
                select OS_USING_LIBC
                default n
                help
                    The default formater is using os_vsnprint and it not supported float number.
                    When enable this option then it will enable libc. The formater will change to vsnprint on libc.

            config DLOG_USING_COLOR
                bool "Enable color log."
                default y
                help
                    The log will has different color by level.

            config DLOG_OUTPUT_TIME_INFO
                bool "Enable time information."
                default y

            config DLOG_TIME_USING_TIMESTAMP
                bool "Enable timestamp format for time."
                default n
                select OS_USING_LIBC
                depends on DLOG_OUTPUT_TIME_INFO

            config DLOG_OUTPUT_LEVEL_INFO
                bool "Enable level information."
                default y

            config DLOG_OUTPUT_TAG_INFO
                bool "Enable tag information."
                default y

            config DLOG_OUTPUT_TASK_NAME_INFO
                bool "Enable task information."
                default n
        endmenu
    endif
endmenu
```

## components/fs/Kconfig
```kconfig
menu "FileSystem"

config OS_USING_VFS
    bool "Enable virtual file system"
    select OS_USING_MUTEX
    default y
    help
        The device file system is a light weight virtual file system.

if OS_USING_VFS
    config VFS_USING_WORKDIR
        bool "Using working directory"
        default y

    config VFS_FILESYSTEMS_MAX
        int "The max number of mounted file system"
        default 4 if OS_USING_VFS_NFS
        default 2

    config VFS_FILESYSTEM_TYPES_MAX
        int "The max number of file system type"
        default 4 if OS_USING_VFS_NFS
        default 2

    config VFS_FD_MAX
        int "The max number of opened files"
        default 16
		
    config OS_USING_VFS_JFFS2
        bool "Enable JFFS2"
        select OS_USING_FAL
        default n
        help
            JFFS2 is journalling flash file system version2.

    config OS_USING_VFS_FATFS
        bool "Enable FatFs"
        select OS_USING_FAL
        default n
        help
            FatFs is a generic FAT/exFAT file system module for small embedded systems.

    if OS_USING_VFS_FATFS
        menu "Elm-ChaN's FatFs, generic FAT filesystem module"
        config OS_VFS_FAT_CODE_PAGE
            int "OEM code page"
            default 437

        choice
            prompt "Support long file name"
            default OS_VFS_FAT_USE_LFN_3

            config OS_VFS_FAT_USE_LFN_0
                bool "0: LFN disable"

            config OS_VFS_FAT_USE_LFN_1
                bool "1: LFN with static LFN working buffer"

            config OS_VFS_FAT_USE_LFN_2
                bool "2: LFN with dynamic LFN working buffer on the stack"

            config OS_VFS_FAT_USE_LFN_3
                bool "3: LFN with dynamic LFN working buffer on the heap"
        endchoice

        config OS_VFS_FAT_USE_LFN
            int
            default 0 if OS_VFS_FAT_USE_LFN_0
            default 1 if OS_VFS_FAT_USE_LFN_1
            default 2 if OS_VFS_FAT_USE_LFN_2
            default 3 if OS_VFS_FAT_USE_LFN_3

        config OS_VFS_FAT_MAX_LFN
            int "Maximal size of file name length"
            range 12 255
            default 255

        config OS_VFS_FAT_DRIVES
            int "Number of volumes (logical drives) to be used."
            default 2

        config OS_VFS_FAT_MAX_SECTOR_SIZE
            int "Maximum sector size to be handled."
            default 4096
            help
                if you use some spi nor flash for fatfs, please set this the erase sector size, for example 4096.

        config OS_VFS_FAT_REENTRANT
            bool "Enable the reentrancy (thread safe) of the FatFs module"
            default y
        endmenu
    endif

    config OS_USING_VFS_DEVFS
        bool "Enable DevFs for device objects"
        default y

    config OS_USING_VFS_CUTEFS
        bool "Enable CuteFs file system"
        select OS_USING_RAMDISK
        default n
        help
            cutefs is a cute filesystem, now only support run on ramdisk.

    config OS_USING_VFS_NFS
        bool "Enable NFS v3 client file system"
        default n

    if OS_USING_VFS_NFS
        config OS_NFS_HOST_EXPORT
            string "NFSv3 host export"
            default "192.168.1.3:/"
    endif

    config OS_USING_VFS_YAFFS
        bool "Enable Yaffs2 file system"
        default n

endif

endmenu
```

## components/gui/Kconfig
```kconfig
menu "GUI"
    config OS_USING_GUI
        bool "Using GUI"
        default n

    if OS_USING_GUI
        config OS_GUI_DISP_DEV_NAME
            string "GUI display dev name"
            default "lcd"
                
        config OS_GUI_INPUT_DEV_NAME
            string "GUI input dev name"
            default "touch"

        config OS_USING_GUI_LVGL
            bool "Enable LittlevGL"
            default n
            
            if OS_USING_GUI_LVGL
                config OS_USING_GUI_LVGL_CONSOLE
                    bool "Enable LittlevGL console"
                    default n
            endif
    endif

endmenu
```

## components/net/Kconfig
```kconfig
menu "Network"

source "$OS_ROOT/components/net/lwip/Kconfig"

source "$OS_ROOT/components/net/molink/Kconfig"

source "$OS_ROOT/components/net/ota/Kconfig"

source "$OS_ROOT/components/net/protocols/Kconfig"

source "$OS_ROOT/components/net/socket/Kconfig"

source "$OS_ROOT/components/net/tools/Kconfig"

endmenu
```
