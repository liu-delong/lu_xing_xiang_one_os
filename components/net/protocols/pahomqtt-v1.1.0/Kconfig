## components/net/protocols/pahomqtt-v1.1.0/Kconfig
```kconfig
menu "MQTT"

config NET_USING_PAHO_MQTT
    bool "Enable Paho MQTT"
    select NET_USING_BSD
    default n
    
    if NET_USING_PAHO_MQTT
		
        config MQTT_USING_TLS
        bool "Enable Paho MQTT TLS encrypt"
        select SECURITY_USING_MBEDTLS
        default n   
			
        config MQTT_USING_SAMPLE
        bool "Enable Paho MQTT sample"
        default n 
    endif
	
endmenu
```

## components/net/protocols/websocket/Kconfig
```kconfig
menu "Websocket"

config NET_USING_WEBSOCKET_CLIENT
    bool "Enable Websocket Client"
    select NET_USING_BSD
    default n

if NET_USING_WEBSOCKET_CLIENT

    source "$OS_ROOT/components/net/protocols/websocket/api/client/Kconfig"

endif

endmenu 
```

## components/net/protocols/websocket/api/client/Kconfig
```kconfig
menu "Websocket Client"


config WEBSOCKET_CLIENT_TASK_MAX_INSTANCE
	int "The maximum number of websocket client instances"
	range 1 9
	default 1	
	
config WEBSOCKET_CLIENT_TASK_STACKSIZE
	int "The stack size of task"
	default 2048
	
config WEBSOCKET_CLIENT_TASK_PRIORITY
	int "The priority level value of task"	
	default 5   if OS_TASK_PRIORITY_8
	default 13  if OS_TASK_PRIORITY_32
	default 64 if OS_TASK_PRIORITY_256
	
config WEBSOCKET_CLIENT_TASK_TICK
	int "The tick of task"
	default 5
	
config WEBSOCKET_CLIENT_MAX_BUFF_DEP
	int "The maximum number of send & rece buffer depth"
	default 1452

config WEBSOCKET_CLIENT_EXAMPLE
    bool "Enable Websocket Client example"
    default n
	
endmenu
```

## components/net/tools/Kconfig
```kconfig
menu "Tools"

config NET_USING_TOOLS
    bool "Enable AT module network debug functions"
    default n
    select NET_USING_IP

    if NET_USING_TOOLS

        config MODULE_USING_IFCONFIG
            bool "Enable module ifconfig features"
            depends on MOLINK_USING_IFCONFIG_OPS
            default y

        config MODULE_USING_PING
            depends on MOLINK_USING_PING_OPS && MOLINK_USING_IFCONFIG_OPS
            bool "Enable module ping features"
            default y

        if MODULE_USING_PING
            config MO_PING_MAX_TIMES_CONFIG
            int "The maximum times of module ping cmd config"
            default 50
        endif 

        config MODULE_USING_SOCKETSTAT
            depends on MOLINK_USING_SOCKETS_OPS
            bool "Enable module socket stat features"
            default y

    endif

endmenu
```

## components/position/Kconfig
```kconfig
menu "OnePos"
	config OS_USING_OnePos
    bool "Enable OnePos"
    default n
	
	if OS_USING_OnePos
		config OS_USING_GNSS_POS
		bool "Enable GNSS Position(NMEA 0183 paraser)."
		default n

		if OS_USING_GNSS_POS
			config NMEA_SERIAL_DEVICE_NAME
				string "Uart name of GNSS using."
				default "uart3"
				
			config GNSS_POS_DEBUG
				bool "Enable GNSS Position debug."
				default n
		endif
		
		config ONEPOS_DEVICE_ID
			string "Device ID by onepos platform alloted."
		
		config ONEPOS_PASSWORD
			string "Password by onepos platform alloted."
		
		config ONEPOS_COMM_REC_BUFF_LEN
			int "Receive buff size of OnePos communication(bytes)."
			default 2048
		
		config ONEPOS_COMM_SEND_BUFF_LEN
			int "Send buff size of OnePos communication(bytes)."
			default 2048

		config ONEPOS_DEFAULT_INTERVAL
			int "Interval of OnePos(should 3 or over)(s)."
			range 3 65535
			default 3	

		config ONEPOS_DEVICE_REC_POS_INFO
            bool "Enable device receive position result."
            default n
			
			if ONEPOS_DEVICE_REC_POS_INFO
				config ONEPOS_REC_SUB_MSG_TIMEOUT
					int "Timeout while device receive position result(ms)."
					range 2900 65535
					default 2900
			endif
		
		config ONEPOS_SUPP_REMOTE_CONF
			bool "Enable remote config."
			default n
		
        config ONEPOS_WIFI_POS
            bool "Enable wifi position."
            default n
			
			if ONEPOS_WIFI_POS
				config ONEPOS_WIFI_DEVICE_NAME
				string "Device name of wifi_pos using."
				default "esp8266"
			endif
		
		config ONEPOS_CELL_POS
            bool "Enable cell position."
            default n
		
			if ONEPOS_CELL_POS
				config ONEPOS_CELL_DEVICE_NAME
				string "Device name of cell_pos using."
				default "ml302"
			endif
		
		config ONEPOS_DEFAULT_POS_MODE
			int "Default position mode(1:sifle wifi; 2:multiple wifis; 3:mutipl cells)."
			range 1 3
			default 2
		
		config ONEPOS_DEFAULT_SEV_PRO
			int "Default position server peovider(0:own;1:OneNET)."
			range 0 1
			default 0
			
		config ONEPOS_DEFAULT_SEV_TYPE
			int "Default position server run type(0:period ciculation;1:single)."
			range 0 1
			default 1
		
		config ONEPOS_DEBUG
            bool "Enable OnePos debug."
            default n
			
		config ONEPOS_CMD
            bool "Enable OnePos CMD."
            default n
		
    endif
endmenu
```

## drivers/Kconfig
```kconfig
menu "Drivers"
    config OS_USING_DEVICE
        bool "Enable device manager"
        default y

    source "$OS_ROOT/drivers/hal/Kconfig"
    source "$OS_ROOT/drivers/audio/Kconfig"    
    source "$OS_ROOT/drivers/misc/Kconfig"
    source "$OS_ROOT/drivers/pin/Kconfig"
    source "$OS_ROOT/drivers/serial/Kconfig"
    source "$OS_ROOT/drivers/watchdog/Kconfig"
    source "$OS_ROOT/drivers/rtc/Kconfig"
    source "$OS_ROOT/drivers/can/Kconfig"
    source "$OS_ROOT/drivers/i2c/Kconfig"
    source "$OS_ROOT/drivers/spi/Kconfig"
    source "$OS_ROOT/drivers/fal/Kconfig"
    source "$OS_ROOT/drivers/rtt/Kconfig"
    source "$OS_ROOT/drivers/timer/Kconfig"
    source "$OS_ROOT/drivers/hwcrypto/Kconfig"
    source "$OS_ROOT/drivers/sdio/Kconfig"
    source "$OS_ROOT/drivers/wlan/Kconfig"
    source "$OS_ROOT/drivers/graphic/Kconfig"
    source "$OS_ROOT/drivers/touch/Kconfig"
    source "$OS_ROOT/drivers/sensors/Kconfig"
    source "$OS_ROOT/drivers/usb/Kconfig"
    source "$OS_ROOT/drivers/infrared/Kconfig"
    source "$OS_ROOT/drivers/lpmgr/Kconfig"
    source "$OS_ROOT/drivers/nand/Kconfig"
    source "$OS_ROOT/drivers/driver_test/Kconfig"
endmenu
```

## drivers/audio/Kconfig
```kconfig
menu "Audio"
    menuconfig OS_USING_AUDIO
        bool "Using audio device drivers"
        default n

        if OS_USING_AUDIO
            menuconfig OS_AUDIO_DATD_CONFIG
                bool "audio data buff parameters config"
                default y
                
                if OS_AUDIO_DATD_CONFIG
                    config OS_AUDIO_REPLAY_MP_BLOCK_SIZE
                    hex "audio reply block size"
                    default 2048
                    
                    config OS_AUDIO_REPLAY_MP_BLOCK_COUNT
                    hex "audio reply block count(please set as hard support buf number add 1)"
                    default 5
                    
                    config OS_AUDIO_RECORD_PIPE_SIZE
                    hex "audio record pipe size"
                    default 2048
                endif
            
            menuconfig OS_USING_SAI
                bool "Using SAI drivers"
                default n
                
                if OS_USING_SAI
                    config BSP_SAI_BLOCK
                    string "sai blcok name"
                    default "sai_BlockA1"
                endif
                                
            config OS_USING_I2S
                bool "Using I2S drivers"
                default n

            menuconfig BSP_USING_ES8388
                bool "Using ES8388 audio device"
                default n

                if BSP_USING_ES8388   
                    menuconfig BSP_USING_ES8388_CONFIG
                        bool "es8388 config bus drivers"
                        default y   
                        
                        if BSP_USING_ES8388_CONFIG
                            config BSP_ES8388_I2C_BUS
                                string "es8388 config bus name"
                                default "i2c3"

                            config BSP_ES8388_I2C_ADDR
                                hex "es8388 config addr"
                                default 0x10
                        endif
                        
                    menuconfig BSP_USING_ES8388_DATA
                        bool "es8388 data bus drivers(i2s/sai)"
                        default y
                        
                        if BSP_USING_ES8388_DATA
                            config BSP_ES8388_DATA_BUS
                                string "es8388 data bus name: i2sx/sai_Blockxx"
                                default "sai_BlockA1"
                        endif
                        
                    config BSP_ES8388_POWER_PIN
                        int "es8388 power pin"
                        default 63
                endif

            menuconfig BSP_USING_VS1003B
                bool "Using VS1003B audio device"
                default n

                if BSP_USING_VS1003B
                    config BSP_VS1003B_SPI_BUS
                        string "vs1003b spi bus name"
                        default "spi2"

                    config BSP_VS1003B_SPI_CS
                        int "vs1003bspi cs pin"
                        default 28
                endif
                
            menuconfig BSP_USING_WM8978
                bool "Using wm8978 audio device"
                default n

                if BSP_USING_WM8978
                    menuconfig BSP_USING_WM8978_CONFIG
                        bool "wm8978 config bus drivers"
                        default y   
                        
                        if BSP_USING_WM8978_CONFIG
                            config BSP_WM8978_I2C_BUS
                                string "wm8978 config bus name"
                                default "i2c3"

                            config BSP_WM8978_I2C_ADDR
                                hex "wm8978 config addr"
                                default 0x1a
                        endif
                        
                    menuconfig BSP_USING_WM8978_DATA
                        bool "wm8978 data bus drivers(i2s/sai)"
                        default y
                        
                        if BSP_USING_WM8978_DATA
                            config BSP_WM8978_DATA_BUS
                                string "wm8978 data bus name: i2sx/sai_Blockxx"
                                default "sai_BlockA1"
                        endif
                        
                    config BSP_WM8978_POWER_PIN
                        int "wm8978 power pin"
                        default 63
                endif
                
            menuconfig BSP_USING_CS43L22
                bool "Using cs43l22 audio device"
                default n

                if BSP_USING_CS43L22
                    menuconfig BSP_USING_CS43L22_CONFIG
                        bool "cs43l22 config bus drivers"
                        default y
                        
                        if BSP_USING_CS43L22_CONFIG
                            config BSP_CS43L22_I2C_BUS
                                string "cs43l22 config bus name"
                                default "i2c3"

                            config BSP_CS43L22_I2C_ADDR
                                hex "cs43l22 config addr"
                                default 0x94
                        endif
                        
                    menuconfig BSP_USING_CS43L22_DATA
                        bool "cs43l22 data bus drivers(i2s/sai)"
                        default y
                        
                        if BSP_USING_CS43L22_DATA
                            config BSP_CS43L22_DATA_BUS
                                string "cs43l22 data bus name: i2sx/sai_Blockxx"
                                default "sai_BlockA1"
                        endif
                        
                    config BSP_CS43L22_RST_PIN
                        int "cs43l22 power pin"
                        default 66
                endif
                
            menuconfig BSP_USING_ISD9160
                bool "Using isd9160 audio device"
                default n

                if BSP_USING_ISD9160
                    menuconfig BSP_USING_ISD9160_CONFIG
                        bool "isd9160 config bus drivers"
                        default y
                        
                        if BSP_USING_ISD9160_CONFIG
                            config BSP_ISD9160_I2C_BUS
                                string "isd9160 config bus name"
                                default "i2c3"

                            config BSP_ISD9160_I2C_ADDR
                                hex "isd9160 config addr"
                                default 0x15
                        endif
                        
                    menuconfig BSP_USING_ISD9160_DATA
                        bool "isd9160 data bus drivers(i2s/sai)"
                        default y
                        
                        if BSP_USING_ISD9160_DATA
                            config BSP_ISD9160_DATA_BUS
                                string "isd9160 data bus name: i2sx/sai_Blockxx"
                                default "sai_BlockA1"
                        endif
                        
                    config BSP_ISD9160_RST_PIN
                        int "isd9160 power pin"
                        default 54
                endif
        endif
endmenu
```

## drivers/driver_test/Kconfig
```kconfig
menuconfig  OS_USING_DRIVERS_SAMPLES
    bool "Drivers samples"
    default n

    if OS_USING_DRIVERS_SAMPLES
        config OS_KEY_DEMO
            bool "Enable key sample"
            default n
            
        config OS_UART_DEMO
            bool "Enable uart sample"
            default n


        config OS_RTC_DEMO
            bool "Enable rtc sample"
            default n

        config OS_WDG_DEMO
            bool "Enable watchdog driver sample"
            default n
            
        config OS_WWDG_DEMO
            bool "Enable window watchdog driver sample"
            default n
        
        config OS_ADC_DEMO
            bool "Enable adc driver sample"
            default n

        config OS_DAC_DEMO
            bool "Enable dac driver sample"
            default n
            
        config OS_CLOCK_DEMO
            bool "Enable clockevent/clocksource/hrtimer sample"
            default n
            
        config OS_PWM_DEMO
            bool "Enable pwm driver sample"
            default n

        config OS_PULSE_ENCODER_DEMO
            bool "Enable pulse encoder driver sample"
            default n
            
        config OS_SENSORS_DEMO
            bool "Enable sensors driver sample"
            default n
                        
        config OS_INFRARED_DEMO
            bool "Enable infrared sample"
            default n
            
        config OS_FAL_TEST_DEMO
            bool "Enable fal sample"
            default n

        config OS_REQUSR_LPMGR_DEMO
            bool "Enable request lpmgr sample"
            default n
            
        config OS_GUI_DEMO
            bool "Enable gui sample"
            default n
            
    endif
```

## drivers/fal/Kconfig
```kconfig
menu "FAL"
    config OS_USING_FAL
        bool "Using flash abstraction layer"
        default n
        
    if OS_USING_FAL
        config OS_FAL_DYNAMIC_FLASH
            bool "Support fal dynamic flash"
            default n
    endif
endmenu
```

## drivers/hal/apollo/Kconfig
```kconfig
config SOC_FAMILY_APOLLO
    bool
    default n

source "$OS_ROOT/drivers/hal/apollo/apollo/Kconfig"
source "$OS_ROOT/drivers/hal/apollo/apollo2/Kconfig"
source "$OS_ROOT/drivers/hal/apollo/apollo3/Kconfig"

source "$OS_ROOT/drivers/hal/apollo/hal_drivers/Kconfig"
```

## drivers/hal/apollo/apollo/Kconfig
```kconfig
config SOC_SERIES_APOLLO
    bool
    select ARCH_ARM_CORTEX_M4
    default n

config SOC_APOLLO_XXX
    bool
    select SOC_FAMILY_APOLLO
    select SOC_SERIES_APOLLO
    default n
```
