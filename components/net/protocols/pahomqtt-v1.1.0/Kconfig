## drivers/hal/apollo/apollo2/Kconfig
```kconfig
config SOC_SERIES_APOLLO2
    bool
    select ARCH_ARM_CORTEX_M4
    default n

config SOC_APOLLO2_XXX
    bool
    select SOC_FAMILY_APOLLO
    select SOC_SERIES_APOLLO2
    default n
```

## drivers/hal/apollo/apollo3/Kconfig
```kconfig
config SOC_SERIES_APOLLO3
    bool
    select ARCH_ARM_CORTEX_M4
    default n

config SOC_APOLLO3_XXX
    bool
    select SOC_FAMILY_APOLLO
    select SOC_SERIES_APOLLO3
    default n
```

## drivers/hal/fm/FM33A0xx_HAL/Kconfig
```kconfig
config SOC_SERIES_FM33A0
    bool
    select ARCH_ARM_CORTEX_M0
    default n

config SOC_FM33A0XX
    bool
    select SOC_FAMILY_FM
    select SOC_SERIES_FM33A0
    default n
```

## drivers/hal/fm/Kconfig
```kconfig
config SOC_FAMILY_FM
    bool
    default n

source "$OS_ROOT/drivers/hal/fm/FM33A0xx_HAL/Kconfig"

source "$OS_ROOT/drivers/hal/fm/hal_drivers/Kconfig"
```

## drivers/hal/fm/hal_drivers/Kconfig
```kconfig
config BSP_USING_GPIO
    bool "Enable GPIO"
    select OS_USING_PIN
    default y

config BSP_USING_LED
    bool "Enable LED"
    select BSP_USING_GPIO
    default y

menuconfig BSP_USING_UART
    bool "Enable UART"
    default y
    select OS_USING_SERIAL
    if BSP_USING_UART
        config BSP_USING_UART0
            bool "Enable UART0"
            default y

        config BSP_USING_UART1
            bool "Enable UART1"
            default n
			
		config BSP_USING_UART2
            bool "Enable UART2"
            default n
			
		config BSP_USING_UART3
            bool "Enable UART3"
            default n
			
		config BSP_USING_UART4
            bool "Enable UART4"
            default n
			
		config BSP_USING_UART5
            bool "Enable UART5"
            default n
    endif

config BSP_USING_ON_CHIP_FLASH
    bool "Enable on-chip FLASH"
    default n

menuconfig BSP_USING_SPI
    bool "Enable SPI BUS"
    default n
    select OS_USING_SPI
    if BSP_USING_SPI
        config BSP_USING_SPI1
            bool "Enable SPI1 BUS"
            default n

        config BSP_USING_SPI2
            bool "Enable SPI2 BUS"
            default n
    endif

menuconfig BSP_USING_I2C
	bool "Enable I2C BUS"
	default n
	select OS_USING_I2C
	select OS_USING_I2C_BITOPS
	select OS_USING_PIN

	menuconfig BSP_USING_I2C1
		depends on BSP_USING_I2C
		bool "Enable I2C1 BUS (software simulation)"
		default n
		if BSP_USING_I2C1
			comment "Notice: PA14 --> 13; PA15 --> 14"
			config BSP_I2C1_SCL_PIN
				int "i2c1 scl pin number"
				range 1 96
				default 13
			config BSP_I2C1_SDA_PIN
				int "I2C1 sda pin number"
				range 1 96
				default 14
		endif


menuconfig BSP_USING_TIM
    bool "Enable timer"
    default n
    select OS_USING_HWTIMER 
    if BSP_USING_TIM
        config OS_USING_BSTIMER1
            bool "Enable BSTIMER1"
            default n
        config OS_USING_BSTIMER2
            bool "Enable BSTIMER2"
            default n
    endif

menuconfig BSP_USING_PWM
    bool "Enable pwm"
    default n
    select OS_USING_PWM
    if BSP_USING_PWM
    menuconfig BSP_USING_PWM1
        bool "Enable timer1 output pwm"
        default n
        if BSP_USING_PWM1
            config BSP_USING_PWM1_CH1
                bool "Enable PWM1 channel1"
                default n
        endif
    endif

menuconfig BSP_USING_ADC
    bool "Enable ADC"
    default n
    select OS_USING_ADC
    if BSP_USING_ADC
        config BSP_USING_ADC1
            bool "Enable ADC1"
            default n
    endif

menuconfig BSP_USING_ONCHIP_RTC
    bool "Enable RTC"
    select OS_USING_RTC
    default n
    if BSP_USING_ONCHIP_RTC
		config BSP_RTC_USING_32768
			bool "RTC USING 32768"
			default n
    endif

config BSP_USING_WDT
    bool "Enable Watchdog Timer"
    select OS_USING_WDT
    default n
```

## drivers/hal/gd/GD32F30x_HAL/Kconfig
```kconfig
config SOC_SERIES_GD32F30X
    bool
    select ARCH_ARM_CORTEX_M4
    default n

config SOC_GD32F303RCT6
    bool
    select SOC_FAMILY_GD32
    select SOC_SERIES_GD32F30X
    default n
```

## drivers/hal/gd/GD32F4xx_HAL/Kconfig
```kconfig
config SOC_SERIES_GD32F4XX
    bool
    select ARCH_ARM_CORTEX_M4
    default n

config SOC_GD32F405RGT6
    bool
    select SOC_FAMILY_GD32F4XX
    select SOC_SERIES_GD32F4XX
    default n

config SOC_GD32F450ZKT6
    bool
    select SOC_FAMILY_GD32F4XX
    select SOC_SERIES_GD32F4XX
    default n

config SOC_GD32F450VIT6
    bool
    select SOC_FAMILY_GD32F4XX
    select SOC_SERIES_GD32F4XX
    default n
```

## drivers/hal/gd/Kconfig
```kconfig
config SOC_FAMILY_GD32
    bool
    default n

config SOC_FAMILY_GD32F4XX
    bool
    default n
	
source "$OS_ROOT/drivers/hal/gd/GD32F30x_HAL/Kconfig"
source "$OS_ROOT/drivers/hal/gd/GD32F4xx_HAL/Kconfig"

if SOC_FAMILY_GD32
source "$OS_ROOT/drivers/hal/gd/drivers/Kconfig"
endif

if SOC_FAMILY_GD32F4XX
source "$OS_ROOT/drivers/hal/gd/drivers_4xx/Kconfig"
endif
```

## drivers/hal/gd/drivers/Kconfig
```kconfig
config BSP_USING_PIN
	bool "pin"
	default n
	
config BSP_USING_USART
	bool "usart"
	default n
	
config BSP_USING_I2C
	bool "i2c"
	default n
	
	if BSP_USING_I2C
		config BSP_USING_I2C0
			bool "i2c0"
			default n
			
		config BSP_USING_I2C1
			bool "i2c1"
			default n
	endif

config BSP_USING_ADC
	bool "adc"
	default n	
	
	if BSP_USING_ADC
		config BSP_USING_ADC0
			bool "adc0"
			default n
			
		config BSP_USING_ADC1
			bool "adc1"
			default n
	endif
	
config BSP_USING_DAC
	bool "dac"
	default n
    if BSP_USING_DAC
        config BSP_USING_DAC0
            bool "dac use dac0"
            default n
        config BSP_USING_DAC1
            bool "dac use dac1"
            default n
    endif	

config BSP_USING_TIMER
	bool "timer"
	default n
	
config BSP_USING_FLASH
	bool "on chip flash"
	default n	
    
config BSP_USING_RTC
	bool "rtc"
	default n	

config BSP_USING_SPI
	bool "spi"
	default n	
	
	if BSP_USING_SPI
		config BSP_USING_SPI0
			bool "spi0"
			default n
			
		config BSP_USING_SPI1
			bool "spi1"
			default n
		
		config BSP_USING_SPI2
			bool "spi2"
			default 2
	endif
```

## drivers/hal/gd32v/drivers/Kconfig
```kconfig
config BSP_USING_PIN
	bool "pin"
	default n

menuconfig BSP_USING_UART
	bool "Enable UART"
	default y
	select OS_USING_SERIAL
	if BSP_USING_UART
		config OS_USING_USART0
			bool "Enable UART0"
			default y

		config OS_USING_USART1
			bool "Enable UART1"
			default y
	endif

config BSP_USING_I2C
	bool "i2c"
	default n

if BSP_USING_I2C
	config BSP_USING_I2C0
		bool "i2c0"
		default n

	config BSP_USING_I2C1
		bool "i2c1"
		default n
endif

menu "Select SPI port"
	depends on OS_USING_SPI
	config BSP_USING_SPI0
		bool "Enable SPI0"
		default y

	config BSP_USING_SPI1
		bool "Enable SPI1"
		default n
endmenu

config BSP_USING_FLASH
	bool "on chip flash"
	default n	
```

## drivers/hal/hc/HC32L13x_HAL/Kconfig
```kconfig
config SOC_SERIES_HC32L13
    bool
	select ARCH_ARM_CORTEX_M0
    default n
	
config SOC_HC32L136K8TA
	bool
	select SOC_FAMILY_HC32
	select SOC_SERIES_HC32L13
	default n
```

## drivers/hal/hc/HC32L17x_HAL/Kconfig
```kconfig
config SOC_SERIES_HC32L17
    bool
	select ARCH_ARM_CORTEX_M0
    default n
	
config SOC_HC32L176KATA
	bool
	select SOC_FAMILY_HC32
	select SOC_SERIES_HC32L17
	default n
```
